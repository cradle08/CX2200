# file: CX100.ioc
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ADC1.Channel-0\#ChannelRegularConversion=ADC_CHANNEL_6
ADC1.ClockPrescaler=ADC_CLOCK_SYNC_PCLK_DIV4
ADC1.ContinuousConvMode=ENABLE
ADC1.DMAContinuousRequests=ENABLE
ADC1.EOCSelection=ADC_EOC_SEQ_CONV
ADC1.NbrOfConversionFlag=1
ADC1.Rank-0\#ChannelRegularConversion=1
ADC1.SamplingTime-0\#ChannelRegularConversion=ADC_SAMPLETIME_3CYCLES
ADC1.ScanConvMode=DISABLE
ADC1.master=1
ADC2.Channel-1\#ChannelRegularConversion=ADC_CHANNEL_3
ADC2.ClockPrescaler=ADC_CLOCK_SYNC_PCLK_DIV4
ADC2.ContinuousConvMode=ENABLE
ADC2.DMAContinuousRequests=ENABLE
ADC2.NbrOfConversionFlag=1
ADC2.Rank-1\#ChannelRegularConversion=1
ADC2.SamplingTime-1\#ChannelRegularConversion=ADC_SAMPLETIME_3CYCLES
ADC3.Channel-1\#ChannelRegularConversion=ADC_CHANNEL_0
ADC3.Channel-11\#ChannelRegularConversion=ADC_CHANNEL_2
ADC3.Channel-12\#ChannelRegularConversion=ADC_CHANNEL_4
ADC3.Channel-13\#ChannelRegularConversion=ADC_CHANNEL_6
ADC3.Channel-14\#ChannelRegularConversion=ADC_CHANNEL_7
ADC3.Channel-15\#ChannelRegularConversion=ADC_CHANNEL_11
ADC3.Channel-16\#ChannelRegularConversion=ADC_CHANNEL_12
ADC3.Channel-17\#ChannelRegularConversion=ADC_CHANNEL_13
ADC3.ClockPrescaler=ADC_CLOCK_SYNC_PCLK_DIV4
ADC3.ContinuousConvMode=ENABLE
ADC3.DMAContinuousRequests=ENABLE
ADC3.NbrOfConversion=8
ADC3.NbrOfConversionFlag=1
ADC3.Rank-1\#ChannelRegularConversion=1
ADC3.Rank-11\#ChannelRegularConversion=2
ADC3.Rank-12\#ChannelRegularConversion=3
ADC3.Rank-13\#ChannelRegularConversion=4
ADC3.Rank-14\#ChannelRegularConversion=5
ADC3.Rank-15\#ChannelRegularConversion=6
ADC3.Rank-16\#ChannelRegularConversion=7
ADC3.Rank-17\#ChannelRegularConversion=8
ADC3.SamplingTime-1\#ChannelRegularConversion=ADC_SAMPLETIME_15CYCLES
ADC3.SamplingTime-11\#ChannelRegularConversion=ADC_SAMPLETIME_15CYCLES
ADC3.SamplingTime-12\#ChannelRegularConversion=ADC_SAMPLETIME_15CYCLES
ADC3.SamplingTime-13\#ChannelRegularConversion=ADC_SAMPLETIME_15CYCLES
ADC3.SamplingTime-14\#ChannelRegularConversion=ADC_SAMPLETIME_15CYCLES
ADC3.SamplingTime-15\#ChannelRegularConversion=ADC_SAMPLETIME_15CYCLES
ADC3.SamplingTime-16\#ChannelRegularConversion=ADC_SAMPLETIME_15CYCLES
ADC3.SamplingTime-17\#ChannelRegularConversion=ADC_SAMPLETIME_15CYCLES
ADC3.ScanConvMode=ENABLE
DMA2D.ColorMode=DMA2D_OUTPUT_RGB565
DMA2D.Mode=DMA2D_R2M
Dma.ADC1.0.Direction=DMA_PERIPH_TO_MEMORY
Dma.ADC1.0.FIFOMode=DMA_FIFOMODE_DISABLE
Dma.ADC1.0.Instance=DMA2_Stream0
Dma.ADC1.0.MemDataAlignment=DMA_MDATAALIGN_HALFWORD
Dma.ADC1.0.MemInc=DMA_MINC_ENABLE
Dma.ADC1.0.Mode=DMA_CIRCULAR
Dma.ADC1.0.PeriphDataAlignment=DMA_PDATAALIGN_HALFWORD
Dma.ADC1.0.PeriphInc=DMA_PINC_DISABLE
Dma.ADC1.0.Priority=DMA_PRIORITY_VERY_HIGH
Dma.ADC2.2.Direction=DMA_PERIPH_TO_MEMORY
Dma.ADC2.2.FIFOMode=DMA_FIFOMODE_DISABLE
Dma.ADC2.2.Instance=DMA2_Stream2
Dma.ADC2.2.MemDataAlignment=DMA_MDATAALIGN_HALFWORD
Dma.ADC2.2.MemInc=DMA_MINC_ENABLE
Dma.ADC2.2.Mode=DMA_CIRCULAR
Dma.ADC2.2.PeriphDataAlignment=DMA_PDATAALIGN_HALFWORD
Dma.ADC2.2.PeriphInc=DMA_PINC_DISABLE
Dma.ADC2.2.Priority=DMA_PRIORITY_LOW
Dma.ADC3.1.Direction=DMA_PERIPH_TO_MEMORY
Dma.ADC3.1.FIFOMode=DMA_FIFOMODE_DISABLE
Dma.ADC3.1.Instance=DMA2_Stream1
Dma.ADC3.1.MemDataAlignment=DMA_MDATAALIGN_HALFWORD
Dma.ADC3.1.MemInc=DMA_MINC_ENABLE
Dma.ADC3.1.Mode=DMA_CIRCULAR
Dma.ADC3.1.PeriphDataAlignment=DMA_PDATAALIGN_HALFWORD
Dma.ADC3.1.PeriphInc=DMA_PINC_DISABLE
Dma.ADC3.1.Priority=DMA_PRIORITY_MEDIUM
Dma.Request0=ADC1
Dma.Request1=ADC3
Dma.Request2=ADC2
Dma.Request3=UART5_TX
Dma.Request4=UART4_RX
Dma.Request5=UART4_TX
Dma.Request6=SPI4_RX
Dma.Request7=SPI4_TX
Dma.Request8=UART5_RX
Dma.Request9=USART1_RX
Dma.SPI4_RX.6.Direction=DMA_PERIPH_TO_MEMORY
Dma.SPI4_RX.6.FIFOMode=DMA_FIFOMODE_DISABLE
Dma.SPI4_RX.6.Instance=DMA2_Stream3
Dma.SPI4_RX.6.MemDataAlignment=DMA_MDATAALIGN_BYTE
Dma.SPI4_RX.6.MemInc=DMA_MINC_ENABLE
Dma.SPI4_RX.6.Mode=DMA_NORMAL
Dma.SPI4_RX.6.PeriphDataAlignment=DMA_PDATAALIGN_BYTE
Dma.SPI4_RX.6.PeriphInc=DMA_PINC_DISABLE
Dma.SPI4_RX.6.Priority=DMA_PRIORITY_HIGH
Dma.SPI4_TX.7.Direction=DMA_MEMORY_TO_PERIPH
Dma.SPI4_TX.7.FIFOMode=DMA_FIFOMODE_DISABLE
Dma.SPI4_TX.7.Instance=DMA2_Stream4
Dma.SPI4_TX.7.MemDataAlignment=DMA_MDATAALIGN_BYTE
Dma.SPI4_TX.7.MemInc=DMA_MINC_ENABLE
Dma.SPI4_TX.7.Mode=DMA_NORMAL
Dma.SPI4_TX.7.PeriphDataAlignment=DMA_PDATAALIGN_BYTE
Dma.SPI4_TX.7.PeriphInc=DMA_PINC_DISABLE
Dma.SPI4_TX.7.Priority=DMA_PRIORITY_MEDIUM
Dma.UART4_RX.4.Direction=DMA_PERIPH_TO_MEMORY
Dma.UART4_RX.4.FIFOMode=DMA_FIFOMODE_DISABLE
Dma.UART4_RX.4.Instance=DMA1_Stream2
Dma.UART4_RX.4.MemDataAlignment=DMA_MDATAALIGN_BYTE
Dma.UART4_RX.4.MemInc=DMA_MINC_ENABLE
Dma.UART4_RX.4.Mode=DMA_CIRCULAR
Dma.UART4_RX.4.PeriphDataAlignment=DMA_PDATAALIGN_BYTE
Dma.UART4_RX.4.PeriphInc=DMA_PINC_DISABLE
Dma.UART4_RX.4.Priority=DMA_PRIORITY_HIGH
Dma.UART4_TX.5.Direction=DMA_MEMORY_TO_PERIPH
Dma.UART4_TX.5.FIFOMode=DMA_FIFOMODE_DISABLE
Dma.UART4_TX.5.Instance=DMA1_Stream4
Dma.UART4_TX.5.MemDataAlignment=DMA_MDATAALIGN_BYTE
Dma.UART4_TX.5.MemInc=DMA_MINC_ENABLE
Dma.UART4_TX.5.Mode=DMA_NORMAL
Dma.UART4_TX.5.PeriphDataAlignment=DMA_PDATAALIGN_BYTE
Dma.UART4_TX.5.PeriphInc=DMA_PINC_DISABLE
Dma.UART4_TX.5.Priority=DMA_PRIORITY_MEDIUM
Dma.UART5_RX.8.Direction=DMA_PERIPH_TO_MEMORY
Dma.UART5_RX.8.FIFOMode=DMA_FIFOMODE_DISABLE
Dma.UART5_RX.8.Instance=DMA1_Stream0
Dma.UART5_RX.8.MemDataAlignment=DMA_MDATAALIGN_BYTE
Dma.UART5_RX.8.MemInc=DMA_MINC_ENABLE
Dma.UART5_RX.8.Mode=DMA_CIRCULAR
Dma.UART5_RX.8.PeriphDataAlignment=DMA_PDATAALIGN_BYTE
Dma.UART5_RX.8.PeriphInc=DMA_PINC_DISABLE
Dma.UART5_RX.8.Priority=DMA_PRIORITY_MEDIUM
Dma.UART5_TX.3.Direction=DMA_MEMORY_TO_PERIPH
Dma.UART5_TX.3.FIFOMode=DMA_FIFOMODE_DISABLE
Dma.UART5_TX.3.Instance=DMA1_Stream7
Dma.UART5_TX.3.MemDataAlignment=DMA_MDATAALIGN_BYTE
Dma.UART5_TX.3.MemInc=DMA_MINC_ENABLE
Dma.UART5_TX.3.Mode=DMA_NORMAL
Dma.UART5_TX.3.PeriphDataAlignment=DMA_PDATAALIGN_BYTE
Dma.UART5_TX.3.PeriphInc=DMA_PINC_DISABLE
Dma.UART5_TX.3.Priority=DMA_PRIORITY_LOW
Dma.USART1_RX.9.Direction=DMA_PERIPH_TO_MEMORY
Dma.USART1_RX.9.FIFOMode=DMA_FIFOMODE_DISABLE
Dma.USART1_RX.9.Instance=DMA2_Stream5
Dma.USART1_RX.9.MemDataAlignment=DMA_MDATAALIGN_BYTE
Dma.USART1_RX.9.MemInc=DMA_MINC_ENABLE
Dma.USART1_RX.9.Mode=DMA_CIRCULAR
Dma.USART1_RX.9.PeriphDataAlignment=DMA_PDATAALIGN_BYTE
Dma.USART1_RX.9.PeriphInc=DMA_PINC_DISABLE
Dma.USART1_RX.9.Priority=DMA_PRIORITY_LOW
FATFS._CODE_PAGE=437
FATFS._FS_LOCK=0
FATFS._FS_NORTC=1
FATFS._NORTC_MDAY=1
FATFS._NORTC_MON=1
FATFS._NORTC_YEAR=2022
FATFS._STRF_ENCODE=0
FATFS._USE_FASTSEEK=0
FATFS._USE_LFN=3
FATFS._USE_MUTEX=0
FATFS._USE_STRFUNC=0
FMC.AttributeSpaceHiZSetupTime1=1
FMC.AttributeSpaceHoldSetupTime1=2
FMC.AttributeSpaceSetupTime1=2
FMC.AttributeSpaceWaitSetupTime1=3
FMC.CASLatency1=FMC_SDRAM_CAS_LATENCY_3
FMC.ColumnBitsNumber1=FMC_SDRAM_COLUMN_BITS_NUM_10
FMC.CommonSpaceHiZSetupTime1=1
FMC.CommonSpaceHoldSetupTime1=2
FMC.CommonSpaceSetupTime1=2
FMC.CommonSpaceWaitSetupTime1=3
FMC.ECCPageSize1=FMC_NAND_ECC_PAGE_SIZE_512BYTE
FMC.EccComputation1=FMC_NAND_ECC_DISABLE
FMC.ExitSelfRefreshDelay1=8
FMC.LoadToActiveDelay1=2
FMC.NandBlockNbr1=64
FMC.NandBlockSize1=64
FMC.NandPageSize1=2112
FMC.NandPlaneNbr1=2048
FMC.NandPlaneSize1=4096
FMC.NandSpareAreaSize1=2048
FMC.RCDDelay1=2
FMC.RPDelay1=2
FMC.RPDelay2=2
FMC.ReadBurst1=FMC_SDRAM_RBURST_ENABLE
FMC.ReadPipeDelay1=FMC_SDRAM_RPIPE_DELAY_1
FMC.RowCycleDelay1=7
FMC.RowCycleDelay2=7
FMC.SDClockPeriod1=FMC_SDRAM_CLOCK_PERIOD_2
FMC.SelfRefreshTime1=5
FMC.TARSetupTime1=1
FMC.TCLRSetupTime1=0
FMC.WriteRecoveryTime1=3
FREERTOS.HEAP_NUMBER=5
FREERTOS.INCLUDE_pcTaskGetTaskName=1
FREERTOS.INCLUDE_uxTaskGetStackHighWaterMark2=1
FREERTOS.INCLUDE_vTaskCleanUpResources=1
FREERTOS.INCLUDE_xEventGroupSetBitFromISR=1
FREERTOS.INCLUDE_xSemaphoreGetMutexHolder=1
FREERTOS.INCLUDE_xTaskAbortDelay=1
FREERTOS.INCLUDE_xTaskGetCurrentTaskHandle=1
FREERTOS.INCLUDE_xTaskGetHandle=1
FREERTOS.Tasks01=Motor,11,1024,MotorTask,Default,NULL,Dynamic,NULL,NULL;PeriodScan,13,600,PeriodScanTask,Default,NULL,Dynamic,NULL,NULL;UI_FrontEnd,14,2048,UI_FrontEndTask,Default,NULL,Dynamic,NULL,NULL;UI_BackEnd,13,2048,UI_BackEndTask,Default,NULL,Dynamic,NULL,NULL;Algo,15,12288,AlgoTask,Default,NULL,Dynamic,NULL,NULL
FREERTOS.configGENERATE_RUN_TIME_STATS=1
FREERTOS.configQUEUE_REGISTRY_SIZE=16
FREERTOS.configRECORD_STACK_HIGH_ADDRESS=1
FREERTOS.configTOTAL_HEAP_SIZE=0x1B800
FREERTOS.configUSE_APPLICATION_TASK_TAG=1
FREERTOS.configUSE_STATS_FORMATTING_FUNCTIONS=1
I2C3.I2C_Mode=I2C_Standard
LTDC.ActiveH=480
LTDC.ActiveW=800
LTDC.Alpha_L0=0xff
LTDC.BlendingFactor1_L0=LTDC_BLENDING_FACTOR1_PAxCA
LTDC.BlendingFactor1_L1=LTDC_BLENDING_FACTOR1_PAxCA
LTDC.BlendingFactor2_L0=LTDC_BLENDING_FACTOR2_PAxCA
LTDC.BlendingFactor2_L1=LTDC_BLENDING_FACTOR2_PAxCA
LTDC.FBStartAdress_L0=LTDC_LAYER_START_ADR
LTDC.FBStartAdress_L1=0xC1200000
LTDC.HBP=46
LTDC.HFP=210
LTDC.HSync=20
LTDC.ImageHeight_L0=480
LTDC.ImageHeight_L1=600
LTDC.ImageWidth_L0=800
LTDC.ImageWidth_L1=1024
LTDC.Layers=0
LTDC.PCPolarity=LTDC_PCPOLARITY_IPC
LTDC.PixelFormat_L0=LTDC_PIXEL_FORMAT_RGB565
LTDC.PixelFormat_L1=LTDC_PIXEL_FORMAT_RGB565
LTDC.VBP=23
LTDC.VFP=22
LTDC.VSync=10
LTDC.WindowX1_L0=800
LTDC.WindowX1_L1=1024
LTDC.WindowY1_L0=480
LTDC.WindowY1_L1=600
Mcu.Family=STM32F4
Mcu.Name=STM32F429I(E-G)Tx
Mcu.Package=LQFP176
Mcu.UserConstants=LTDC_LAYER_START_ADR,0xC0000000
NVIC.DMA1_Stream0_IRQn=true\:10\:0\:true\:false\:true\:true\:false\:true
NVIC.DMA1_Stream2_IRQn=true\:10\:0\:true\:false\:true\:true\:false\:true
NVIC.DMA1_Stream4_IRQn=true\:10\:0\:true\:false\:true\:true\:false\:true
NVIC.DMA1_Stream7_IRQn=true\:10\:0\:true\:false\:true\:true\:false\:true
NVIC.DMA2_Stream0_IRQn=true\:3\:0\:true\:false\:true\:true\:false\:true
NVIC.DMA2_Stream1_IRQn=true\:6\:0\:true\:false\:false\:true\:false\:false
NVIC.DMA2_Stream2_IRQn=true\:3\:0\:true\:false\:true\:true\:false\:true
NVIC.DMA2_Stream3_IRQn=true\:5\:0\:true\:false\:true\:true\:false\:false
NVIC.DMA2_Stream4_IRQn=true\:5\:0\:true\:false\:true\:true\:false\:false
NVIC.DMA2_Stream5_IRQn=true\:14\:0\:true\:false\:true\:true\:false\:true
NVIC.EXTI15_10_IRQn=true\:7\:0\:true\:false\:true\:false\:true\:true
NVIC.EXTI9_5_IRQn=true\:7\:0\:true\:false\:true\:false\:true\:true
NVIC.LTDC_IRQn=true\:7\:0\:true\:false\:true\:false\:true\:true
NVIC.OTG_FS_IRQn=true\:9\:0\:true\:false\:true\:true\:false\:true
NVIC.PriorityGroup=NVIC_PRIORITYGROUP_4
NVIC.TIM1_UP_TIM10_IRQn=true\:0\:0\:false\:false\:true\:false\:false\:true
NVIC.TIM2_IRQn=true\:6\:0\:true\:false\:true\:true\:true\:false
NVIC.TIM3_IRQn=true\:6\:0\:true\:false\:true\:true\:true\:false
NVIC.TimeBase=TIM1_UP_TIM10_IRQn
NVIC.TimeBaseIP=TIM10
NVIC.UART4_IRQn=true\:10\:0\:true\:false\:true\:true\:true\:true
NVIC.UART5_IRQn=true\:10\:0\:true\:false\:true\:true\:true\:true
NVIC.USART1_IRQn=true\:14\:0\:true\:false\:true\:true\:true\:true
PA0/WKUP.GPIO_Label=PRESS_AIN
PA0/WKUP.Signal=ADCx_IN0
PA1.GPIO_Label=BEEP_PWM
PA1.GPIO_Speed=GPIO_SPEED_FREQ_MEDIUM
PA1.Signal=S_TIM5_CH2
PA10.GPIO_Label=USART1_RX
PA10.Mode=Asynchronous
PA10.Signal=USART1_RX
PA11.Mode=Host_Only
PA11.Signal=USB_OTG_FS_DM
PA12.Mode=Host_Only
PA12.Signal=USB_OTG_FS_DP
PA13.Mode=Serial_Wire
PA13.Signal=SYS_JTMS-SWDIO
PA14.Mode=Serial_Wire
PA14.Signal=SYS_JTCK-SWCLK
PA15.GPIO_Label=CLAMP_MOTOR_PWM
PA15.GPIO_Speed=GPIO_SPEED_FREQ_VERY_HIGH
PA15.Signal=GPIO_Output
PA2.GPIO_Label=HGB_AIN
PA2.Signal=ADCx_IN2
PA3.GPIO_Label=RBC_PLT
PA3.Signal=ADCx_IN3
PA4.GPIO_Label=LIGHT_CUR_DAC
PA4.Signal=COMP_DAC1_group
PA5.GPIO_Label=MOTOR_CUR_DAC
PA5.Signal=COMP_DAC2_group
PA6.GPIO_Label=WBC_AIN
PA6.Signal=ADCx_IN6
PA7.GPIO_Label=LIQUID_VALVE
PA7.GPIO_Speed=GPIO_SPEED_FREQ_LOW
PA7.Signal=GPIO_Output
PA8.GPIO_Label=OUTIN_IN_OC
PA8.GPIO_PuPd=GPIO_NOPULL
PA8.Signal=GPIO_Input
PA9.GPIO_Label=USART1_TX
PA9.Mode=Asynchronous
PA9.Signal=USART1_TX
PB0.GPIO_Label=AIR_VALVE
PB0.GPIO_Speed=GPIO_SPEED_FREQ_LOW
PB0.Signal=GPIO_Output
PB1.GPIO_Label=LED0
PB1.GPIO_Speed=GPIO_SPEED_FREQ_HIGH
PB1.PinState=GPIO_PIN_SET
PB1.Signal=GPIO_Output
PB10.GPIO_Label=CAT_PWRKEY
PB10.GPIO_PuPd=GPIO_PULLUP
PB10.GPIO_Speed=GPIO_SPEED_FREQ_VERY_HIGH
PB10.Signal=GPIO_Output
PB11.GPIO_Label=CAT_RESET
PB11.GPIO_PuPd=GPIO_PULLUP
PB11.GPIO_Speed=GPIO_SPEED_FREQ_VERY_HIGH
PB11.Signal=GPIO_Output
PB12.GPIO_Label=COUNT_CELL_CHECK
PB12.GPIO_PuPd=GPIO_NOPULL
PB12.Signal=GPIO_Input
PB13.GPIO_Label=COUNT_CELL_TYPE_CHECK
PB13.Signal=GPIO_Input
PB14.GPIO_Speed=GPIO_SPEED_FREQ_HIGH
PB14.Signal=S_TIM12_CH1
PB15.GPIO_Label=FLASH_SPI_CS
PB15.GPIO_PuPd=GPIO_PULLUP
PB15.GPIO_Speed=GPIO_SPEED_FREQ_HIGH
PB15.PinState=GPIO_PIN_SET
PB15.Signal=GPIO_Output
PB3.GPIO_Label=OUTIN_MOTOR_EN
PB3.GPIO_Speed=GPIO_SPEED_FREQ_HIGH
PB3.PinState=GPIO_PIN_SET
PB3.Signal=GPIO_Output
PB4.GPIO_Label=OUTIN_MOTOR_DIR
PB4.GPIO_Speed=GPIO_SPEED_FREQ_HIGH
PB4.Signal=GPIO_Output
PB5.GPIO_Label=LCD_BL
PB5.GPIO_PuPd=GPIO_NOPULL
PB5.GPIO_Speed=GPIO_SPEED_FREQ_LOW
PB5.PinState=GPIO_PIN_RESET
PB5.Signal=GPIO_Output
PB6.GPIO_Label=PUMP_PWM
PB6.GPIO_Speed=GPIO_SPEED_FREQ_HIGH
PB6.Signal=S_TIM4_CH1
PB7.GPIO_Label=LCD_PWR
PB7.GPIO_Speed=GPIO_SPEED_FREQ_HIGH
PB7.PinState=GPIO_PIN_SET
PB7.Signal=GPIO_Output
PB8.GPIO_Label=CLAMP_MOTOR_EN
PB8.GPIO_Speed=GPIO_SPEED_FREQ_HIGH
PB8.PinState=GPIO_PIN_SET
PB8.Signal=GPIO_Output
PB9.GPIO_Label=CLAMP_MOTOR_DIR
PB9.GPIO_Speed=GPIO_SPEED_FREQ_HIGH
PB9.Signal=GPIO_Output
PC0.Signal=FMC_SDNWE
PC1.GPIO_Label=XK_AIN
PC1.Signal=ADCx_IN11
PC10.Mode=Asynchronous
PC10.Signal=UART4_TX
PC11.Mode=Asynchronous
PC11.Signal=UART4_RX
PC12.GPIO_Label=PRINT_UART5_TX
PC12.Mode=Asynchronous
PC12.Signal=UART5_TX
PC13.GPIO_Label=BC_COUNT_KEY
PC13.GPIO_ModeDefaultEXTI=GPIO_MODE_IT_FALLING
PC13.GPIO_PuPd=GPIO_PULLUP
PC13.Signal=GPXTI13
PC14/OSC32_IN.GPIO_Label=MENU_GREEN
PC14/OSC32_IN.GPIO_Speed=GPIO_SPEED_FREQ_LOW
PC14/OSC32_IN.PinState=GPIO_PIN_RESET
PC14/OSC32_IN.Signal=GPIO_Output
PC15/OSC32_OUT.GPIO_Label=MENU_RED
PC15/OSC32_OUT.PinState=GPIO_PIN_RESET
PC15/OSC32_OUT.Signal=GPIO_Output
PC2.GPIO_Label=P12V_AIN
PC2.Signal=ADCx_IN12
PC3.GPIO_Label=N12V_AIN
PC3.Signal=ADCx_IN13
PC4.GPIO_Label=CAT_STATUS
PC4.GPIO_PuPd=GPIO_PULLUP
PC4.Signal=GPIO_Input
PC6.GPIO_Label=OUTIN_MOTOR_PWM
PC6.GPIO_Speed=GPIO_SPEED_FREQ_VERY_HIGH
PC6.Signal=GPIO_Output
PC7.GPIO_Label=CLAMP_OUT_OC
PC7.GPIO_Mode=GPIO_MODE_INPUT
PC7.GPIO_PuPd=GPIO_NOPULL
PC7.Signal=GPIO_Input
PC8.GPIO_Label=CLAMP_IN_OC
PC8.GPIO_PuPd=GPIO_NOPULL
PC8.Signal=GPIO_Input
PC9.GPIO_Label=OUTIN_OUT_OC
PC9.GPIO_PuPd=GPIO_NOPULL
PC9.Signal=GPIO_Input
PD0.Signal=FMC_D2_DA2
PD1.Signal=FMC_D3_DA3
PD10.Signal=FMC_D15_DA15
PD11.Signal=FMC_A16_CLE
PD12.Signal=FMC_A17_ALE
PD13.GPIO_Label=COUNT_CELL_SW
PD13.GPIO_Speed=GPIO_SPEED_FREQ_LOW
PD13.Signal=GPIO_Output
PD14.Signal=FMC_D0_DA0
PD15.Signal=FMC_D1_DA1
PD2.GPIO_Label=PRINT_UART5_RX
PD2.Mode=Asynchronous
PD2.Signal=UART5_RX
PD3.GPIO_Label=COUNT_SIGNAL_SW
PD3.Signal=GPIO_Output
PD4.Signal=FMC_NOE
PD5.Signal=FMC_NWE
PD7.GPIO_Label=LCD_RST
PD7.GPIO_Speed=GPIO_SPEED_FREQ_LOW
PD7.PinState=GPIO_PIN_SET
PD7.Signal=GPIO_Output
PD8.Signal=FMC_D13_DA13
PD9.Signal=FMC_D14_DA14
PE0.Signal=FMC_NBL0
PE1.Signal=FMC_NBL1
PE10.Signal=FMC_D7_DA7
PE11.Signal=FMC_D8_DA8
PE12.Signal=FMC_D9_DA9
PE13.Signal=FMC_D10_DA10
PE14.Signal=FMC_D11_DA11
PE15.Signal=FMC_D12_DA12
PE2.GPIO_PuPd=GPIO_PULLUP
PE2.Mode=Full_Duplex_Master
PE2.Signal=SPI4_SCK
PE3.GPIO_Label=DR0_SPI_CS
PE3.GPIO_Speed=GPIO_SPEED_FREQ_HIGH
PE3.PinState=GPIO_PIN_SET
PE3.Signal=GPIO_Output
PE4.GPIO_Label=DR1_SPI_CS
PE4.GPIO_Speed=GPIO_SPEED_FREQ_HIGH
PE4.PinState=GPIO_PIN_SET
PE4.Signal=GPIO_Output
PE5.GPIO_PuPd=GPIO_PULLUP
PE5.Mode=Full_Duplex_Master
PE5.Signal=SPI4_MISO
PE6.GPIO_PuPd=GPIO_PULLUP
PE6.GPIO_Speed=GPIO_SPEED_FREQ_VERY_HIGH
PE6.Mode=Full_Duplex_Master
PE6.Signal=SPI4_MOSI
PE7.Signal=FMC_D4_DA4
PE8.Signal=FMC_D5_DA5
PE9.Signal=FMC_D6_DA6
PF0.Signal=FMC_A0
PF1.Signal=FMC_A1
PF10.GPIO_Speed=GPIO_SPEED_FREQ_HIGH
PF10.Mode=RGB565
PF10.Signal=LTDC_DE
PF11.Signal=FMC_SDNRAS
PF12.Signal=FMC_A6
PF13.Signal=FMC_A7
PF14.Signal=FMC_A8
PF15.Signal=FMC_A9
PF2.Signal=FMC_A2
PF3.Signal=FMC_A3
PF4.Signal=FMC_A4
PF5.Signal=FMC_A5
PF6.GPIO_Label=ELEC_AIN
PF6.Mode=IN4
PF6.Signal=ADC3_IN4
PF7.GPIO_Label=BC_CURRENT_SW
PF7.Signal=GPIO_Output
PF8.GPIO_Label=NTC_AIN
PF8.Mode=IN6
PF8.Signal=ADC3_IN6
PF9.GPIO_Label=BC_CUR_AIN
PF9.Mode=IN7
PF9.Signal=ADC3_IN7
PG0.Signal=FMC_A10
PG1.Signal=FMC_A11
PG10.GPIO_Label=XPT_PENIRQ
PG10.GPIO_PuPd=GPIO_PULLUP
PG10.Signal=GPIO_Input
PG11.GPIO_Speed=GPIO_SPEED_FREQ_HIGH
PG11.Mode=RGB565
PG11.Signal=LTDC_B3
PG12.GPIO_Label=TP_SPI_CS
PG12.GPIO_Speed=GPIO_SPEED_FREQ_HIGH
PG12.PinState=GPIO_PIN_SET
PG12.Signal=GPIO_Output
PG13.Signal=ETH_TXD0
PG14.Signal=ETH_TXD1
PG15.Signal=FMC_SDNCAS
PG2.Signal=FMC_A12
PG3.GPIO_Label=COUNT_CELL_TYPE_SW
PG3.GPIO_Speed=GPIO_SPEED_FREQ_HIGH
PG3.Signal=GPIO_Output
PG4.Signal=FMC_A14_BA0
PG5.Signal=FMC_A15_BA1
PG6.GPIO_Speed=GPIO_SPEED_FREQ_HIGH
PG6.Mode=RGB565
PG6.Signal=LTDC_R7
PG7.GPIO_Speed=GPIO_SPEED_FREQ_HIGH
PG7.Mode=RGB565
PG7.Signal=LTDC_CLK
PG8.Signal=FMC_SDCLK
PG9.Mode=NandChipSelect3_1
PG9.Signal=FMC_NCE3
PH0/OSC_IN.Mode=HSE-External-Oscillator
PH0/OSC_IN.Signal=RCC_OSC_IN
PH1/OSC_OUT.Mode=HSE-External-Oscillator
PH1/OSC_OUT.Signal=RCC_OSC_OUT
PH10.GPIO_Speed=GPIO_SPEED_FREQ_HIGH
PH10.Mode=RGB565
PH10.Signal=LTDC_R4
PH11.GPIO_Speed=GPIO_SPEED_FREQ_HIGH
PH11.Mode=RGB565
PH11.Signal=LTDC_R5
PH12.GPIO_Speed=GPIO_SPEED_FREQ_HIGH
PH12.Mode=RGB565
PH12.Signal=LTDC_R6
PH13.GPIO_Speed=GPIO_SPEED_FREQ_HIGH
PH13.Mode=RGB565
PH13.Signal=LTDC_G2
PH14.GPIO_Speed=GPIO_SPEED_FREQ_HIGH
PH14.Mode=RGB565
PH14.Signal=LTDC_G3
PH15.GPIO_Speed=GPIO_SPEED_FREQ_HIGH
PH15.Mode=RGB565
PH15.Signal=LTDC_G4
PH2.Mode=SdramChipSelect1_1
PH2.Signal=FMC_SDCKE0
PH3.Mode=SdramChipSelect1_1
PH3.Signal=FMC_SDNE0
PH4.Mode=I2C
PH4.Signal=I2C2_SCL
PH5.Mode=I2C
PH5.Signal=I2C2_SDA
PH6.GPIO_Label=LIGHT_SW
PH6.GPIO_Speed=GPIO_SPEED_FREQ_HIGH
PH6.Signal=GPIO_Output
PH7.GPIO_Label=I2C3_SCL
PH7.Mode=I2C
PH7.Signal=I2C3_SCL
PH8.GPIO_Label=I2C_SDA
PH8.Mode=I2C
PH8.Signal=I2C3_SDA
PH9.GPIO_Speed=GPIO_SPEED_FREQ_HIGH
PH9.Mode=RGB565
PH9.Signal=LTDC_R3
PI0.GPIO_Speed=GPIO_SPEED_FREQ_HIGH
PI0.Mode=RGB565
PI0.Signal=LTDC_G5
PI1.GPIO_Speed=GPIO_SPEED_FREQ_HIGH
PI1.Mode=RGB565
PI1.Signal=LTDC_G6
PI10.GPIO_Speed=GPIO_SPEED_FREQ_HIGH
PI10.Mode=RGB565
PI10.Signal=LTDC_HSYNC
PI11.GPIO_Label=NAND_WP
PI11.GPIO_Speed=GPIO_SPEED_FREQ_HIGH
PI11.PinState=GPIO_PIN_SET
PI11.Signal=GPIO_Output
PI2.GPIO_Speed=GPIO_SPEED_FREQ_HIGH
PI2.Mode=RGB565
PI2.Signal=LTDC_G7
PI3.GPIO_Label=ELEC
PI3.GPIO_PuPd=GPIO_PULLUP
PI3.Signal=GPIO_Input
PI4.GPIO_Speed=GPIO_SPEED_FREQ_HIGH
PI4.Mode=RGB565
PI4.Signal=LTDC_B4
PI5.GPIO_Speed=GPIO_SPEED_FREQ_HIGH
PI5.Mode=RGB565
PI5.Signal=LTDC_B5
PI6.GPIO_Speed=GPIO_SPEED_FREQ_HIGH
PI6.Mode=RGB565
PI6.Signal=LTDC_B6
PI7.GPIO_Speed=GPIO_SPEED_FREQ_HIGH
PI7.Mode=RGB565
PI7.Signal=LTDC_B7
PI8.GPIO_Label=OUTIN_KEY
PI8.GPIO_ModeDefaultEXTI=GPIO_MODE_IT_FALLING
PI8.GPIO_PuPd=GPIO_PULLUP
PI8.Signal=GPXTI8
PI9.GPIO_Speed=GPIO_SPEED_FREQ_HIGH
PI9.Mode=RGB565
PI9.Signal=LTDC_VSYNC
ProjectManager.HeapSize=0x1000
ProjectManager.StackSize=0x2000
ProjectManager.TargetToolchain=MDK-ARM V5.27
RCC.48MHZClocksFreq_Value=48000000
RCC.AHBFreq_Value=168000000
RCC.APB1CLKDivider=RCC_HCLK_DIV4
RCC.APB1Freq_Value=42000000
RCC.APB1TimFreq_Value=84000000
RCC.APB2CLKDivider=RCC_HCLK_DIV2
RCC.APB2Freq_Value=84000000
RCC.APB2TimFreq_Value=168000000
RCC.CortexFreq_Value=168000000
RCC.HCLKFreq_Value=168000000
RCC.HSE_VALUE=25000000
RCC.HSI_VALUE=16000000
RCC.LSE_VALUE=32768
RCC.PLLM=25
RCC.PLLN=336
RCC.PLLQ=7
RCC.PLLSAIDivR=RCC_PLLSAIDIVR_4
RCC.PLLSAIN=396
RCC.PLLSAIR=3
RCC.SYSCLKFreq_VALUE=168000000
RCC.SYSCLKSource=RCC_SYSCLKSOURCE_PLLCLK
RCC.VCOOutputFreq_Value=336000000
SH.ADCx_IN0.0=ADC3_IN0,IN0
SH.ADCx_IN11.0=ADC3_IN11,IN11
SH.ADCx_IN12.0=ADC3_IN12,IN12
SH.ADCx_IN13.0=ADC3_IN13,IN13
SH.ADCx_IN2.0=ADC3_IN2,IN2
SH.ADCx_IN3.0=ADC2_IN3,IN3
SH.ADCx_IN6.0=ADC1_IN6,IN6
SH.COMP_DAC1_group.0=DAC_OUT1,DAC_OUT1
SH.COMP_DAC2_group.0=DAC_OUT2,DAC_OUT2
SH.FMC_A0.0=FMC_A0,13b-sda1
SH.FMC_A1.0=FMC_A1,13b-sda1
SH.FMC_A10.0=FMC_A10,13b-sda1
SH.FMC_A11.0=FMC_A11,13b-sda1
SH.FMC_A12.0=FMC_A12,13b-sda1
SH.FMC_A14_BA0.0=FMC_BA0,FourSdramBanks1
SH.FMC_A15_BA1.0=FMC_BA1,FourSdramBanks1
SH.FMC_A16_CLE.0=FMC_CLE,8b-dmux1
SH.FMC_A17_ALE.0=FMC_ALE,8b-dmux1
SH.FMC_A2.0=FMC_A2,13b-sda1
SH.FMC_A3.0=FMC_A3,13b-sda1
SH.FMC_A4.0=FMC_A4,13b-sda1
SH.FMC_A5.0=FMC_A5,13b-sda1
SH.FMC_A6.0=FMC_A6,13b-sda1
SH.FMC_A7.0=FMC_A7,13b-sda1
SH.FMC_A8.0=FMC_A8,13b-sda1
SH.FMC_A9.0=FMC_A9,13b-sda1
SH.FMC_D0_DA0.0=FMC_D0,sd-16b-d1
SH.FMC_D0_DA0.1=FMC_D0,8b-dmux1
SH.FMC_D10_DA10.0=FMC_D10,sd-16b-d1
SH.FMC_D11_DA11.0=FMC_D11,sd-16b-d1
SH.FMC_D12_DA12.0=FMC_D12,sd-16b-d1
SH.FMC_D13_DA13.0=FMC_D13,sd-16b-d1
SH.FMC_D14_DA14.0=FMC_D14,sd-16b-d1
SH.FMC_D15_DA15.0=FMC_D15,sd-16b-d1
SH.FMC_D1_DA1.0=FMC_D1,sd-16b-d1
SH.FMC_D1_DA1.1=FMC_D1,8b-dmux1
SH.FMC_D2_DA2.0=FMC_D2,sd-16b-d1
SH.FMC_D2_DA2.1=FMC_D2,8b-dmux1
SH.FMC_D3_DA3.0=FMC_D3,sd-16b-d1
SH.FMC_D3_DA3.1=FMC_D3,8b-dmux1
SH.FMC_D4_DA4.0=FMC_D4,sd-16b-d1
SH.FMC_D4_DA4.1=FMC_D4,8b-dmux1
SH.FMC_D5_DA5.0=FMC_D5,sd-16b-d1
SH.FMC_D5_DA5.1=FMC_D5,8b-dmux1
SH.FMC_D6_DA6.0=FMC_D6,sd-16b-d1
SH.FMC_D6_DA6.1=FMC_D6,8b-dmux1
SH.FMC_D7_DA7.0=FMC_D7,sd-16b-d1
SH.FMC_D7_DA7.1=FMC_D7,8b-dmux1
SH.FMC_D8_DA8.0=FMC_D8,sd-16b-d1
SH.FMC_D9_DA9.0=FMC_D9,sd-16b-d1
SH.FMC_NBL0.0=FMC_NBL0,Sd2ByteEnable1
SH.FMC_NBL1.0=FMC_NBL1,Sd2ByteEnable1
SH.FMC_NOE.0=FMC_NOE,8b-dmux1
SH.FMC_NWE.0=FMC_NWE,8b-dmux1
SH.FMC_SDCLK.0=FMC_SDCLK,13b-sda1
SH.FMC_SDNCAS.0=FMC_SDNCAS,13b-sda1
SH.FMC_SDNRAS.0=FMC_SDNRAS,13b-sda1
SH.FMC_SDNWE.0=FMC_SDNWE,13b-sda1
SH.S_TIM12_CH1.0=TIM12_CH1,PWM Generation1 CH1
SH.S_TIM4_CH1.0=TIM4_CH1,PWM Generation1 CH1
SH.S_TIM5_CH2.0=TIM5_CH2,PWM Generation2 CH2
SPI4.BaudRatePrescaler=SPI_BAUDRATEPRESCALER_256
SPI4.CRCCalculation=SPI_CRCCALCULATION_DISABLE
SPI4.CalculateBaudRate=328.125 KBits/s
SPI4.Direction=SPI_DIRECTION_2LINES
SPI4.Mode=SPI_MODE_MASTER
SPI4.VirtualType=VM_MASTER
TIM12.AutoReloadPreload=TIM_AUTORELOAD_PRELOAD_ENABLE
TIM12.Channel-PWM\ Generation1\ CH1=TIM_CHANNEL_1
TIM12.Period=10000
TIM12.Prescaler=9-1
TIM12.Pulse-PWM\ Generation1\ CH1=50
TIM2.AutoReloadPreload=TIM_AUTORELOAD_PRELOAD_DISABLE
TIM2.Period=3250-1
TIM2.Prescaler=7-1
TIM3.AutoReloadPreload=TIM_AUTORELOAD_PRELOAD_DISABLE
TIM3.Period=3250-1
TIM3.Prescaler=7-1
TIM4.AutoReloadPreload=TIM_AUTORELOAD_PRELOAD_ENABLE
TIM4.Channel-PWM\ Generation1\ CH1=TIM_CHANNEL_1
TIM4.Period=6250
TIM4.Prescaler=18-1
TIM4.Pulse-PWM\ Generation1\ CH1=3125
TIM5.AutoReloadPreload=TIM_AUTORELOAD_PRELOAD_ENABLE
TIM5.Channel-PWM\ Generation2\ CH2=TIM_CHANNEL_2
TIM5.Period=2500
TIM5.Prescaler=9-1
TIM5.Pulse-PWM\ Generation2\ CH2=1250
UART4.BaudRate=115200
UART4.VirtualMode=Asynchronous
UART5.VirtualMode=Asynchronous
USART1.VirtualMode=VM_ASYNC
USB_HOST.USBH_DEBUG_LEVEL-MSC_FS=0
USB_HOST.USBH_HandleTypeDef-MSC_FS=hUsbHostFS
USB_HOST.USBH_PROCESS_STACK_SIZE-MSC_FS=1024
USB_HOST.VirtualModeFS=Msc
USB_OTG_FS.VirtualMode=Host_Only
USB_OTG_FS.phy_itface=HCD_PHY_EMBEDDED
VP_CRC_VS_CRC.Mode=CRC_Activate
VP_DMA2D_VS_DMA2D.Mode=DMA2D_Activate
VP_FATFS_VS_USB.Mode=USB
VP_FREERTOS_VS_CMSIS_V2.Mode=CMSIS_V2
VP_SYS_VS_tim10.Mode=TIM10
VP_TIM2_VS_ClockSourceINT.Mode=Internal
VP_TIM3_VS_ClockSourceINT.Mode=Internal
VP_USB_HOST_VS_USB_HOST_MSC_FS.Mode=MSC_FS
board=custom

// file: Src/main.c
/* USER CODE BEGIN Header */
/**
  ******************************************************************************
  * @file           : main.c
  * @brief          : Main program body
  ******************************************************************************
  * @attention
  *
  * <h2><center>&copy; Copyright (c) 2020 STMicroelectronics.
  * All rights reserved.</center></h2>
  *
  * This software component is licensed by ST under BSD 3-Clause license,
  * the "License"; You may not use this file except in compliance with the
  * License. You may obtain a copy of the License at:
  *                        opensource.org/licenses/BSD-3-Clause
  *
  ******************************************************************************
  */
/* USER CODE END Header */

#include "main.h"
#include "cmsis_os.h"
#include "adc.h"
#include "crc.h"
#include "dac.h"
#include "dma.h"
#include "dma2d.h"
#include "fatfs.h"
#include "i2c.h"
#include "ltdc.h"
#include "spi.h"
#include "tim.h"
#include "usart.h"
#include "usb_host.h"
#include "gpio.h"
#include "fmc.h"

/* USER CODE BEGIN Includes */
#include "bsp_nand.h"
#include "ftl.h"
#include "bsp_sdram.h"
#include "portable.h"
#include "bsp_outin.h"
#include "ltdc.h"
//#include "bsp_touch.h"
#include "bsp_adc.h"
#include "bsp_pump.h"
#include "bsp_outin.h"
#include "bsp_motor.h"
#include "cmsis_os2.h"
#include "GUI.h"
#include "flash.h"
#include "backend_msg.h"
#include "bsp_light.h"
#include "bsp_resistance.h"
#include "bsp_beep.h"
#include "file_operate.h"
//#include "cm_backtrace.h"
#include "file_operate.h"
#include "CAT_iot.h"
#include "bsp_spi.h"
#include "parameter.h"
#include "process.h"
#include "Printer.h"
#include "usart1CMD.h"
#include "Common.h"
#include "bsp_eeprom.h"

#if !USE_RL_FLASH_FS
#include "fatfs.h"
#endif
/* USER CODE END Includes */

/* USER CODE BEGIN PTD */
//仪器信息
MachInfo_s MachInfo __attribute__ ((at(SDRAM_MACHINE_INFO_ADDR))) = {0};

//UI 数据结构体
__IO MachRunPara_s MachRunPara __attribute__((at(SDRAM_MACH_RUN_PARA_ADDR))) = {0};

//外部账号样本分析数据容量
OutSideDataNum_s OutSideDataNum = {0};

//
Panel_LED_Status_e g_ePanel_LED_Status = PANEL_LED_STATUS_NORMAL;         		//面板指示灯运行状态，
__IO OutIn_Module_Position_e g_eOutIn_Key = OUTIN_MODULE_POSITION_NUKNOWN; 		//进出仓模块位置，进出仓方向控制
__IO uint8_t g_ucOutInKey = 0;                                             		//进出仓按键状态,用于退出GIF
__IO uint8_t g_Count_Key = RESET;               								//计数按键标志
__IO DataManage_t g_tDataManage = {0};          								//数据管理全局结构体
__IO LogLevel_e g_eLogLevel = LOG_LEVEL_INFO;   								//LOG_LEVEL_INFO; //当前默认日志输出级别
HAL_StatusTypeDef SystemStartFlag = HAL_ERROR;									//定义操作系统是否已经启动的标志，HAL_OK表示已经启动完成，这里主要目的是防止系统还未启动就触发中断，并且中断中使用了系统的API，从而导致异常发生
#define MCU_FLASH_MAIN_SOFTWARE_START_ADR		32*1024							//定义主程序存放在MCU的FLASH中的起始位置的偏移量

/* USER CODE END PTD */

/* USER CODE BEGIN PV */

/***************************************************************
*
*   其他任务栈(30k)+队列等(8k)+算法（50k）= 88k。系统堆栈：88+20(free)=108。 STM32F429igt6:256k。 剩余：256-108-64=84
*
***************************************************************/

const HeapRegion_t xHeapRegions[] =
{
	{ ( uint8_t * ) 0x10000000UL, 0x10000 },        //64k
    { ( uint8_t * ) 0x20000000UL, 0x10000 },        //64k
 	{ NULL, 0 }
};

/* USER CODE END PV */

void SystemClock_Config(void);
void MX_FREERTOS_Init(void);
/* USER CODE BEGIN PFP */
static void Bsp_Init(void);
/* USER CODE END PFP */

/* USER CODE BEGIN 0 */

/*
*	外设初始化设置
*/
static void Bsp_Init(void)
{
    extern __IO OutIn_Module_Position_e  g_eOutIn_Key;
	extern volatile CAT_ReceBuf_s CATReceBuf;
	extern PrinterReceBuf_s PrinterReceBuf;
	extern Usart1ReceBuf_s Usart1ReceBuf;
	extern  MachInfo_s    MachInfo;

	// SDRAM 设置部分
	Bsp_SDRAM_Init();

    //nand写保护功能，off
    NAND_WP_ON;

    //设置电机默认驱动电流
    Motor_Set_Current(MOTOR_CURRENT_VALUE_START);

    //关闭光路输出（用于HGB灯）
    Light_Stop();

    //上电后 面板指示灯，运行状态
    Panel_Led_Status(RUN_MODE_NORMAL, PANEL_LED_STATUS_NORMAL);

    //LCD背光
    LCD_BL_OFF;

	//WBC恒流源关
	BC_CUR_SW_OFF;

	#if USE_RL_FLASH_FS
		NAND_Reset();
    #endif

    //电机对应定时器，
    MTx_Timer_Init();

    //启动ADC3，各个监控电压
	ADC3_Start();

    //关阀，关泵
	Pump_Stop();
	LIQUID_WAVE_CLOSE;
	AIR_WAVE_CLOSE;

    //失能所有spi外设, 在需要时再开启
    SPI_CS_Disable_All();

    //开启SPI，用于电阻触摸xpt2046，数值电位器等
   __HAL_SPI_ENABLE(&hspi4);

   //开启IIC，用于EEPROM、RTC
   __HAL_I2C_ENABLE(&hi2c3);

   //蜂鸣器初始化
   Beep_Init();

    //计数模式初始化
   CountMode_Init();

   //开启Usart1的空闲中断
	__HAL_UART_ENABLE_IT(&huart1,UART_IT_IDLE);

	//开启USART1的RX--DMA循环模式
	HAL_UART_Receive_DMA(&huart1,(uint8_t*)Usart1ReceBuf.buf,USART1_RECE_BUF_LEN+1);

   //开启Uart4的空闲中断
	__HAL_UART_ENABLE_IT(&huart4,UART_IT_IDLE);

	//开启UART4的RX--DMA循环模式
	HAL_UART_Receive_DMA(&huart4,(uint8_t*)CATReceBuf.buf,CAT_RECE_BUF_SIZE+1);

	//开启Uart5的空闲中断
	__HAL_UART_ENABLE_IT(&huart5,UART_IT_IDLE);

	//开启UART5的RX--DMA循环模式
	HAL_UART_Receive_DMA(&huart5,(uint8_t*)PrinterReceBuf.buf,PRINTER_RECE_BUF_LEN+1);

	//初始化SPI4的DMA请求
	hspi4.Instance->CR2 |= SPI_CR2_RXDMAEN;
	hspi4.Instance->CR2 |= SPI_CR2_TXDMAEN;
	DMA2_Stream3->PAR = (uint32_t)&SPI4->DR;
	DMA2_Stream4->PAR = (uint32_t)&SPI4->DR;

	//初始化SPI FLASH
	SPIFlash_Init();

	//显示版本信息，编译时间
	LOG_Info("MCU Version=%d, BuildDate=%s %s，SDRAM_ADR_END:%x，EEPROM_ADR_END:%u\r\n", MAIN_VERSION, __DATE__, __TIME__,SDRAM_END_ADDR,EEPROM_ADD_END);
}

/*
*	微妙延时函数
*/
void Delay_US(uint32_t us)
{
    uint32_t start, now, delta, reload, us_tick;
    start = SysTick->VAL;
    reload = SysTick->LOAD;
    us_tick = SystemCoreClock / 1000000UL;
    do {
        now = SysTick->VAL;
        delta = start > now ? start - now : reload + start - now;
    } while(delta < us_tick * us);
}

/*
*   延时ulTime毫秒, 超过指定时间时，返回TRUE，非堵塞执行
*/
Bool Delay_Until(uint32_t ulTime)
{
    static uint32_t sulEndTime = 0;
    static Bool eStatus = FALSE;

    if(eStatus == FALSE)
    {
        //sulEndTime = osKernelGetTickCount() + ulTime;
        sulEndTime = HAL_GetTick() + ulTime;
        eStatus = TRUE;
        return FALSE;
    }
    //
    if(eStatus == TRUE)
    {
        if(HAL_GetTick() >= sulEndTime)
        {
            sulEndTime = 0;
            eStatus = FALSE;
            return TRUE;
        }else{
            return FALSE;
        }
    }
    //
    return FALSE;
}

/*
*   运用延时函数，根据模块不同的运行方式，选择不同延时方式,
*/
void App_Delay(RunMode_e eRunMode, uint32_t ulTime)
{
    if(RUN_MODE_NORMAL == eRunMode)
    {
        //非堵塞延时，
        osDelay(ulTime);
    }else if(RUN_MODE_COUNT == eRunMode){
        //堵塞延时
        HAL_Delay(ulTime);
    }
}

/*
* 软件重启
*/
void Soft_Reboot(void)
{
    __disable_irq();
    NVIC_SystemReset();
}

/* USER CODE END 0 */

int main(void)
{
  /* USER CODE BEGIN 1 */
  extern __IO MachRunPara_s MachRunPara;

	/***
	设置APP程序的中断向量表偏移量，否则，会导致APP上产生的中断会进入IAP的中断处理函数，这个偏移量需要根据APP在FLASH中的起始地址偏移量来得到。
	注意需要手动设置IROM1与实际的FLASH存放的起始地址一致
	***/
	SCB->VTOR = FLASH_BASE | MCU_FLASH_MAIN_SOFTWARE_START_ADR;
	__enable_irq();

	//开启总中断
  /* USER CODE END 1 */

  /* MCU Configuration--------------------------------------------------------*/

  /* Reset of all peripherals, Initializes the Flash interface and the Systick. */
  HAL_Init();

  /* USER CODE BEGIN Init */
    /**********************************************************************
    *   TIM2=MOTOR_CLAMP,   TIM3=OUTIN_MOTOR,       TIM10=HAL_Ticks
    *   TIM4=PUMP,          TIM12=内部工装信号,
    *
    ************************************************************************/
  /* USER CODE END Init */

  /* Configure the system clock */
  SystemClock_Config();

  /* Initialize all configured peripherals */
  MX_GPIO_Init();
  MX_DMA_Init();
  MX_USART1_UART_Init();
  MX_ADC1_Init();
  MX_FMC_Init();
  MX_CRC_Init();
  MX_DMA2D_Init();
  MX_LTDC_Init();
  MX_ADC3_Init();
  MX_TIM4_Init();
  MX_ADC2_Init();
  MX_DAC_Init();
  MX_TIM2_Init();
  MX_TIM3_Init();
  MX_SPI4_Init();
  MX_I2C3_Init();
  MX_UART5_Init();
  MX_TIM12_Init();
  MX_UART4_Init();
  MX_TIM5_Init();
  MX_I2C2_Init();
  MX_FATFS_Init();
  /* USER CODE BEGIN 2 */
  Bsp_Init();

  vPortDefineHeapRegions(xHeapRegions);
  /* USER CODE END 2 */

  /* Init scheduler */
  osKernelInitialize();  /* Call init function for freertos objects (in freertos.c) */
  MX_FREERTOS_Init();
  /* Start scheduler */
  osKernelStart();

  /* We should never get here as control is now taken by the scheduler */
  /* Infinite loop */
    while (1)
    {

    }
}

void SystemClock_Config(void)
{
  RCC_OscInitTypeDef RCC_OscInitStruct = {0};
  RCC_ClkInitTypeDef RCC_ClkInitStruct = {0};
  RCC_PeriphCLKInitTypeDef PeriphClkInitStruct = {0};

  /** Configure the main internal regulator output voltage
  */
  __HAL_RCC_PWR_CLK_ENABLE();
  __HAL_PWR_VOLTAGESCALING_CONFIG(PWR_REGULATOR_VOLTAGE_SCALE1);
  /** Initializes the CPU, AHB and APB busses clocks
  */
  RCC_OscInitStruct.OscillatorType = RCC_OSCILLATORTYPE_HSE;
  RCC_OscInitStruct.HSEState = RCC_HSE_ON;
  RCC_OscInitStruct.PLL.PLLState = RCC_PLL_ON;
  RCC_OscInitStruct.PLL.PLLSource = RCC_PLLSOURCE_HSE;
  RCC_OscInitStruct.PLL.PLLM = 25;
  RCC_OscInitStruct.PLL.PLLN = 336;
  RCC_OscInitStruct.PLL.PLLP = RCC_PLLP_DIV2;
  RCC_OscInitStruct.PLL.PLLQ = 7;
  if (HAL_RCC_OscConfig(&RCC_OscInitStruct) != HAL_OK)
  {
    Error_Handler();
  }
  /** Initializes the CPU, AHB and APB busses clocks
  */
  RCC_ClkInitStruct.ClockType = RCC_CLOCKTYPE_HCLK|RCC_CLOCKTYPE_SYSCLK
                              |RCC_CLOCKTYPE_PCLK1|RCC_CLOCKTYPE_PCLK2;
  RCC_ClkInitStruct.SYSCLKSource = RCC_SYSCLKSOURCE_PLLCLK;
  RCC_ClkInitStruct.AHBCLKDivider = RCC_SYSCLK_DIV1;
  RCC_ClkInitStruct.APB1CLKDivider = RCC_HCLK_DIV4;
  RCC_ClkInitStruct.APB2CLKDivider = RCC_HCLK_DIV2;

  if (HAL_RCC_ClockConfig(&RCC_ClkInitStruct, FLASH_LATENCY_5) != HAL_OK)
  {
    Error_Handler();
  }
  PeriphClkInitStruct.PeriphClockSelection = RCC_PERIPHCLK_LTDC;
  PeriphClkInitStruct.PLLSAI.PLLSAIN = 396;
  PeriphClkInitStruct.PLLSAI.PLLSAIR = 3;
  PeriphClkInitStruct.PLLSAIDivR = RCC_PLLSAIDIVR_4;
  if (HAL_RCCEx_PeriphCLKConfig(&PeriphClkInitStruct) != HAL_OK)
  {
    Error_Handler();
  }
}

 /**
  * @brief  Period elapsed callback in non blocking mode
  * @note   This function is called  when TIM10 interrupt took place, inside
  * HAL_TIM_IRQHandler(). It makes a direct call to HAL_IncTick() to increment
  * a global variable "uwTick" used as application time base.
  * @param  htim : TIM handle
  * @retval None
  */
void HAL_TIM_PeriodElapsedCallback(TIM_HandleTypeDef *htim)
{
  if (htim->Instance == TIM10) {
    HAL_IncTick();
  }
}

void Error_Handler(void)
{
  /* USER CODE BEGIN Error_Handler_Debug */
    /* User can add his own implementation to report the HAL error return state */

    LOG_Info("Error_Handler: %s, %d", __FUNCTION__, __LINE__);
    while(1);
  /* USER CODE END Error_Handler_Debug */
}

/************************ (C) COPYRIGHT STMicroelectronics *****END OF FILE****/

// file: Src/freertos.c
/* USER CODE BEGIN Header */
/**
  ******************************************************************************
  * File Name          : freertos.c
  * Description        : Code for freertos applications
  ******************************************************************************
  * @attention
  *
  * <h2><center>&copy; Copyright (c) 2020 STMicroelectronics.
  * All rights reserved.</center></h2>
  *
  * This software component is licensed by ST under Ultimate Liberty license
  * SLA0044, the "License"; You may not use this file except in compliance with
  * the License. You may obtain a copy of the License at:
  *                             www.st.com/SLA0044
  *
  ******************************************************************************
  */
/* USER CODE END Header */

#include "FreeRTOS.h"
#include "task.h"
#include "main.h"
#include "cmsis_os.h"

/* USER CODE BEGIN Includes */
#include <stdlib.h>
#include "cmsis_os2.h"
//#include "lwip/netbuf.h"
//#include "lwip.h"
#include "fmc.h"
#include "lcd.h"
#include "ltdc.h"
//#include "bsp_touch.h"
#include "cx_menu.h"
#include "bc.h"
#include "usart.h"
#include "process.h"
#include "bsp_outin.h"
#include "bsp_pump.h"
#include "bsp_light.h"
#include "bsp_motor.h"
#include "bsp_press.h"
#include "ftl.h"
#include "file_operate.h"
#include "bsp_nand.h"
#include "ui_msg.h"
#include "msg_def.h"
#include "backend_msg.h"
#include "cx_menu.h"
#include "monitorV.h"
#include "tp.h"
//#include "inputTask.h"
#include "xpt2046.h"
#include "bsp_rtc.h"
#include "bsp_eeprom.h"
#include "parameter.h"
#include "Public_menuDLG.h"
#include "Printer.h"
#include "PrinterTask.h"
#include "GUI_Touch.h"
#include "bsp_countsignal.h"
#include "bsp_resistance.h"
#include "CAT_iotTask.h"
#include "PrinterTask.h"
#include "usart1CMD.h"
#include "LISTVIEW.h"
#include "EDIT.h"
#include "DROPDOWN.h"
#include "TEXT.h"
#include "pcba.h"
#include "ZhiJian.h"

/* USER CODE END Includes */

/* USER CODE BEGIN Variables */
__IO osSemaphoreId_t xSema_OutIn_Key   = NULL;	//进出仓
__IO osSemaphoreId_t xSema_Count_Key   = NULL;	//计数信号量
__IO osMutexId_t     xMutex_Com        = NULL;  //公共互斥锁

__IO uint8_t g_OutIn_Module_Status     = 0;    //进仓模块，在任务中的状态， 0：无动作，1：动作
__IO uint8_t g_CountHandle_Status      = 0;    //计数模块，在任务中的状态， 0：无动作，1：正在处理中（用于控制指示灯的均匀闪耀）

/* USER CODE END Variables */
/* Definitions for Motor */
osThreadId_t MotorHandle;
const osThreadAttr_t Motor_attributes = {
  .name = "Motor",
  .priority = (osPriority_t) osPriorityLow3,
  .stack_size = 1024 * 4
};
/* Definitions for PeriodScan */
osThreadId_t PeriodScanHandle;
const osThreadAttr_t PeriodScan_attributes = {
  .name = "PeriodScan",
  .priority = (osPriority_t) osPriorityLow6,
  .stack_size = 600 * 4
};
/* Definitions for UI_FrontEnd */
osThreadId_t UI_FrontEndHandle;
const osThreadAttr_t UI_FrontEnd_attributes = {
  .name = "UI_FrontEnd",
  .priority = (osPriority_t) osPriorityLow7,
  .stack_size = 2048 * 4
};
/* Definitions for UI_BackEnd */
osThreadId_t UI_BackEndHandle;
const osThreadAttr_t UI_BackEnd_attributes = {
  .name = "UI_BackEnd",
  .priority = (osPriority_t) osPriorityLow6,
  .stack_size = 2048 * 4
};
/* Definitions for Algo */
osThreadId_t AlgoHandle;
const osThreadAttr_t Algo_attributes = {
  .name = "Algo",
  .priority = (osPriority_t) osPriorityBelowNormal,
  .stack_size = 12288 * 4
};

/* USER CODE BEGIN FunctionPrototypes */
//osPriorityLow: 3 5 6 6 7
osThreadId_t PrintHandle;
const osThreadAttr_t Print_attributes = {
  .name = "Print",
  .priority = (osPriority_t) osPriorityLow3,
  .stack_size = 1024 * 4
};

osThreadId_t PrintStatusHandle;
const osThreadAttr_t PrintStatus_attributes = {
  .name = "PrintStatus",
  .priority = (osPriority_t) osPriorityLow2,
  .stack_size = 512 * 4
};

osThreadId_t CATUpdateStatusTaskHandle;
const osThreadAttr_t CATUpdateStatus_attributes = {
  .name = "CATUpdateStatusTask",
  .priority = (osPriority_t) osPriorityLow4,
  .stack_size = 640*4
};

osThreadId_t CATTaskHandle;
const osThreadAttr_t CATTask_attributes = {
  .name = "CATTask",
  .priority = (osPriority_t) osPriorityLow4,
  .stack_size = 1280 * 4
};

osThreadId_t CATOtherTaskHandle;
const osThreadAttr_t CATOtherTask_attributes = {
  .name = "CAT_OtherTask",
  .priority = (osPriority_t) osPriorityLow5,
  .stack_size = 512 * 4
};

osThreadId_t Usart1CMDHandle;
const osThreadAttr_t Usart1CMD_attributes = {
  .name = "Usart1CMD",
  .priority = (osPriority_t) osPriorityLow,
  .stack_size = 1024 * 4
};

/*
*   运行过程中栈的最小值
*/
void Printf_Free_StackSize(void)
{
    LOG_Info("Algo:%d", osThreadGetStackSpace(AlgoHandle));
    LOG_Info("UI_F:%d", osThreadGetStackSpace(UI_FrontEndHandle));
    LOG_Info("UI_B:%d", osThreadGetStackSpace(UI_BackEndHandle));    //可用堆栈空间
    LOG_Info("Motor:%d", osThreadGetStackSpace(MotorHandle));
    LOG_Info("Print:%d", osThreadGetStackSpace(PrintHandle));
	LOG_Info("Print_S:%d", osThreadGetStackSpace(PrintStatusHandle));
    LOG_Info("Usart1CMD:%d", osThreadGetStackSpace(Usart1CMDHandle));
    LOG_Info("CATTask:%d", osThreadGetStackSpace(CATTaskHandle));
	LOG_Info("CATTas_S:%d", osThreadGetStackSpace(CATUpdateStatusTaskHandle));
	LOG_Info("OtherCatTask:%d", osThreadGetStackSpace(CATOtherTaskHandle));
	LOG_Info("Scan:%d", osThreadGetStackSpace(PeriodScanHandle));
	LOG_Info("CurFreeHeap:%u", xPortGetFreeHeapSize());
	LOG_Info("MinFreeHeap:%u", xPortGetMinimumEverFreeHeapSize());
}

/* USER CODE END FunctionPrototypes */

void MotorTask(void *argument);
void PeriodScanTask(void *argument);
void UI_FrontEndTask(void *argument);
void UI_BackEndTask(void *argument);
void AlgoTask(void *argument);

extern void MX_USB_HOST_Init(void);
void MX_FREERTOS_Init(void); /* (MISRA C 2004 rule 8.1) */

/* Hook prototypes */
void configureTimerForRunTimeStats(void);
unsigned long getRunTimeCounterValue(void);

/* USER CODE BEGIN 1 */
/* Functions needed when configGENERATE_RUN_TIME_STATS is on */
__weak void configureTimerForRunTimeStats(void)
{

}

__weak unsigned long getRunTimeCounterValue(void)
{
return 0;
}

void GUI_TouchTask(void *argument);

/* USER CODE END 1 */

void MX_FREERTOS_Init(void) {
  /* USER CODE BEGIN Init */

    extern osMessageQueueId_t xUIQueue;
    extern osMessageQueueId_t xBackEndQueue;
    extern __IO osMutexId_t   xMutex_Com;
    extern osEventFlagsId_t GlobalEventOtherGroupHandle;
	extern osEventFlagsId_t GlobalEventPrintGroupHandle;
	extern osEventFlagsId_t GlobalEventCatGroupHandle;
    extern osSemaphoreId_t  SemphrCountPrinterTxHandle;
    extern osSemaphoreId_t  SemphrBinPrinterRxHandle;
    extern osMessageQueueId_t PrinterInfoQueueHandle;
	extern osMessageQueueId_t CATQueueHandle;
	extern HAL_StatusTypeDef SystemStartFlag;
	extern osSemaphoreId_t CATSemphrCountTxHandle;
	extern osSemaphoreId_t CATSemphrBinRxHandle;
	extern osSemaphoreId_t Usart1RxSempBinHandle;

	extern osSemaphoreId_t CATSemMutexHandle;
	extern osMessageQueueId_t CATQueueOtherHandle;

  /* USER CODE END Init */

  /* USER CODE BEGIN RTOS_SEMAPHORES */
  /* add semaphores, ... */
    //信号量
	xSema_OutIn_Key = osSemaphoreNew(1, 0, NULL);
	xSema_Count_Key = osSemaphoreNew(1, 0, NULL);
    //消息队列
	xUIQueue        = osMessageQueueNew(3, UI_TO_BACKEND_MSG_BUFFER_LEN, NULL);
	xBackEndQueue   = osMessageQueueNew(2, BACKEND_TO_UI_MSG_BUFFER_LEN, NULL);
    //互斥锁
    xMutex_Com      = osMutexNew(NULL);

    SemphrCountPrinterTxHandle   = osSemaphoreNew(1, 1, NULL);
    SemphrBinPrinterRxHandle     = osSemaphoreNew(1, 0, NULL);
    PrinterInfoQueueHandle       = osMessageQueueNew(1, sizeof(PrinterInfoData_s), NULL);

	//===全局事件组相关===
    GlobalEventOtherGroupHandle  = osEventFlagsNew(NULL);
	GlobalEventPrintGroupHandle  = osEventFlagsNew(NULL);
	GlobalEventCatGroupHandle    = osEventFlagsNew(NULL);

//    xEvent_BC = osEventFlagsNew(NULL);
  /* USER CODE END RTOS_SEMAPHORES */

  /* Create the thread(s) */
  /* creation of Motor */
  MotorHandle = osThreadNew(MotorTask, NULL, &Motor_attributes);

  /* creation of PeriodScan */
  PeriodScanHandle = osThreadNew(PeriodScanTask, NULL, &PeriodScan_attributes);

  /* creation of UI_FrontEnd */
  UI_FrontEndHandle = osThreadNew(UI_FrontEndTask, NULL, &UI_FrontEnd_attributes);

  /* creation of UI_BackEnd */
  UI_BackEndHandle = osThreadNew(UI_BackEndTask, NULL, &UI_BackEnd_attributes);

  /* creation of Algo */
  AlgoHandle = osThreadNew(AlgoTask, NULL, &Algo_attributes);

  /* USER CODE BEGIN RTOS_THREADS */
//===打印机相关==========================================================
  PrintHandle = osThreadNew(PrinterTask, NULL, &Print_attributes);
  PrintStatusHandle = osThreadNew(PrinterIsOKTask, NULL, &PrintStatus_attributes);

//===CAT模块相关=========================================================
	//查询CAT是否OK，以及状态初始化和更新任务
	CATUpdateStatusTaskHandle = osThreadNew(CATUpdateStatusTask, NULL, &CATUpdateStatus_attributes);
	CATTaskHandle = osThreadNew(CATTask, NULL, &CATTask_attributes);

	//创建CAT模块发送数据相关计数信号量
	CATSemphrCountTxHandle = osSemaphoreNew(1, 1, NULL);

	//创建CAT模块接收相关二值信号量
	CATSemphrBinRxHandle = osSemaphoreNew(1, 0, NULL);

	//创建用于传递CAT发布消息的消息队列
	CATQueueHandle = osMessageQueueNew(10, sizeof(CATQueueInfoBuf_s), NULL);

	//===第三方服务端通讯相关===
	CATOtherTaskHandle = osThreadNew(CAT_OtherTask, NULL, &CATOtherTask_attributes);

	//创建用于传递CAT发布消息的消息队列
	CATQueueOtherHandle = osMessageQueueNew(5, sizeof(CATQueueInfoBuf_s), NULL);

	//互斥创怀和第三方服务端的计数信号量
	CATSemMutexHandle = osSemaphoreNew(1, 1, NULL);

//===USART1调试命令相关=========================================================
	Usart1CMDHandle = osThreadNew(Usart1CMDTask, NULL, &Usart1CMD_attributes);

	//创建串口1接收相关二值信号量
	Usart1RxSempBinHandle = osSemaphoreNew(1, 0, NULL);

//===失能电机和算法任务==========================
	Disable_Motor_Task();
	Disable_Algo_Task();

//===置位系统已启动标志===================================================================
	SystemStartFlag = HAL_OK;

	//机器状态参数(数据保存在eeprom)
    LOG_Info("Machine Info Size=%d, WBCHGB Data Size=%d", sizeof(MachInfo_s), sizeof(WBCHGB_TestInfo_t));
    Machine_Info_Init(&MachInfo);

  /* USER CODE END RTOS_THREADS */

}

/* USER CODE BEGIN Header_MotorTask */
/**
  * @brief  Function implementing the Motor thread.
  * @param  argument: Not used
  * @retval None
  */

/*
*   挂起motor任务
*/
void Disable_Motor_Task(void)
{
	uint16_t Count = 0;

	//当进出电机，还未执行完成时，等待其完成
    while(1 == g_OutIn_Module_Status)
    {
        //未执行完成
        osDelay(50);
        if(0 == g_OutIn_Module_Status || ++Count > 220) //进出仓模块执行完成，或超过11s
        {
            break;
        }
    }
	g_OutIn_Module_Status = 0;

    osSemaphoreAcquire(xSema_OutIn_Key, 0); //挂起前清除信号量
    osThreadSuspend(MotorHandle);
}

/*
*   恢复motor任务
*/
void Enable_Motor_Task(Bool eFlag)
{
	extern __IO OutIn_Module_Position_e g_eOutIn_Key;

    //true清信号量，false不清除
    if(TRUE == eFlag)
    {
        osSemaphoreAcquire(xSema_OutIn_Key, 0); //挂起前清除信号量
    }

	//检测电机位置
    g_eOutIn_Key = OutIn_Module_Positon();

    osThreadResume(MotorHandle);
}

/* USER CODE END Header_MotorTask */
void MotorTask(void *argument)
{
  /* init code for USB_HOST */
//  MX_USB_HOST_Init();
  /* USER CODE BEGIN MotorTask */
  /* Infinite loop */
    extern MachInfo_s MachInfo;
    extern __IO OutIn_Module_Position_e g_eOutIn_Key;
	extern __IO osSemaphoreId xSema_OutIn_Key;
    ErrorCode_e eErrorCode = ERROR_CODE_SUCCESS;
	RunLog_s RunLog = {0};
	RTC_HYM8563Info_s RTCInfo = {0};
	uint32_t ulIndex = 0;

    //检测电机初始位置
    g_eOutIn_Key = OutIn_Module_Positon();

  /* Infinite loop */
	for(;;)
	{
		osSemaphoreAcquire(xSema_OutIn_Key, osWaitForever);

		g_eOutIn_Key = OutIn_Module_Positon();
		g_eOutIn_Key = !g_eOutIn_Key;

        //执行动作
        g_OutIn_Module_Status = 1;
        eErrorCode = OutIn_Module_Out_Or_In(MOTOR_MODE_NORMAL);

        if(OUTIN_MODULE_POSITION_IN == g_eOutIn_Key && ERROR_CODE_CLAMP_OUT == eErrorCode)
        {
            //如果进仓异常，则需要松开夹子
            if(FEED_BACK_SUCCESS != Motor_Run_AddStep(MOTOR_MODE_NORMAL, MOTOR_CLAMP, MOTOR_DIR_IN, MachInfo.paramSet.ulClamp_In_AddStep))
            {
                eErrorCode = ERROR_CODE_CLAMP_IN;
            }
        }

		//更新进仓位置信息，防止偶发未进仓的情况
        g_eOutIn_Key = OutIn_Module_Positon();

        if(OUTIN_MODULE_POSITION_NUKNOWN == g_eOutIn_Key || FEED_BACK_SUCCESS != eErrorCode)
        {
            //进仓异常（暂定于只有在样本分析界面执行进出仓，提示告警信息）
            WM_MESSAGE tMsg = {0};
            tMsg.hWin  = g_hActiveWin;
            tMsg.MsgId = WM_MOTOR_ERROR_PROMPT;
            tMsg.Data.v = eErrorCode;
            WM_SendMessage(g_hActiveWin, &tMsg);

			//保存运行日志
			RunLog.logHead.logLen = 0;
			RunLog.logHead.logLen += sprintf(RunLog.Str+RunLog.logHead.logLen,"Movement Failure\r\n");
			RunLog.Str[RunLog.logHead.logLen] = '\0';
			RunLog.logHead.num = g_tDataManage.ulRunLog_SN;//g_tDataManage.lastRunLogNum;
			RunLog.logHead.eAccountType = MachInfo.accountMM.accountInfo[MachInfo.accountMM.curIndex].type;
			RTC_HYM8563GetTime(&RTCInfo);
			sprintf(RunLog.logHead.dataTime,"20%d%d-%d%d-%d%d %d%d:%d%d:%d%d",
							RTCInfo.year.bcd_h,RTCInfo.year.bcd_l,
							RTCInfo.month.bcd_h,RTCInfo.month.bcd_l,
							RTCInfo.day.bcd_h,RTCInfo.day.bcd_l,
							RTCInfo.hour.bcd_h,RTCInfo.hour.bcd_l,
							RTCInfo.min.bcd_h,RTCInfo.min.bcd_l,
							RTCInfo.sec.bcd_h,RTCInfo.sec.bcd_l);
			ulIndex = sprintf(RunLog.logHead.shortStr,"Abnormal");
			RunLog.logHead.shortStr[ulIndex] = '\0';
			RunLog.logHead.timestamp = GetCurrentTimestamp(RTCInfo);
            RunLog.usCrc = CRC16((uint8_t*)&RunLog, sizeof(RunLog_s)-2);

            ulIndex = Update_RunLog_Tail();
			Fatfs_Write_RunLog(ulIndex, &RunLog);
			g_tDataManage.ulRunLog_SN++;//g_tDataManage.lastRunLogNum++;
            Add_RunLog_Tail();
			Save_DataMange_Info(&g_tDataManage);
        }

		//按键有抖动，多次触发时，去掉最后一次消息触发
        osSemaphoreAcquire(xSema_OutIn_Key, 0);

        //动作完成
        g_OutIn_Module_Status = 0;

		osDelay(1);
    }
  /* USER CODE END MotorTask */
}

void PeriodScanTask(void *argument)
{
  /* USER CODE BEGIN PeriodScanTask */
  /* Infinite loop */

    extern MachInfo_s MachInfo;
    extern __IO MachRunPara_s MachRunPara;
    uint32_t ulTemp1 = 0, ulTemp2 = 0, i = 0, ulTemp4 = 0;

    for(;;)
    {
        i++;
        if(i - ulTemp1 >= 50) // 1S
        {
            ulTemp1 = i;
            LED0_TRIGGLE;

//			Printf_Free_StackSize();
        }
        //
        if(i - ulTemp2 >= 250) // 5S
        {
            ulTemp2 = i;
            //更新时间,UI显示时间
            RTC_Read((uint8_t*)MachRunPara.ucaLastestDateTime, DATE_TIME_LEN);
        }

        //
        if(i - ulTemp4 >= 25) //500ms
        {
            ulTemp4 = i;
            if(1 == g_CountHandle_Status)
            {
                Panel_Led_Status(RUN_MODE_COUNT, g_ePanel_LED_Status); //面板灯计数模式，闪耀
            }else{
                Panel_Led_Status(RUN_MODE_NORMAL, g_ePanel_LED_Status);  //面板灯正常模式，常亮，不闪耀
            }
        }

		//触摸扫描
        Touch_Scan();

        osDelay(20);
    }
  /* USER CODE END PeriodScanTask */
}

/* USER CODE BEGIN Header_UI_FrontEndTask */
/**
* @brief Function implementing the UI_FrontEnd thread.
* @param argument: Not used
* @retval None
*/

/*
*   挂起 FrontEnd任务
*/
void Disable_FrontEnd_Task(void)
{
    osThreadSuspend(MotorHandle);
}

/*
*   恢复FrontEnd任务
*/
void Enable_FrontEnd_Task(void)
{
   osThreadResume(UI_FrontEndHandle);
}

/* USER CODE END Header_UI_FrontEndTask */
void UI_FrontEndTask(void *argument)
{
  /* USER CODE BEGIN UI_FrontEndTask */
    /* Infinite loop */
	extern WM_HWIN DialogWin;
	extern MachInfo_s MachInfo;
	extern WM_HWIN CreateDialogPage(void);
	extern WM_HWIN CreatePCBA_Page(void);
	CommonDialogPageData_s DialogPageData = {0};
	WM_MESSAGE pMsg;
	uint32_t ulTick = 0;

    //STemWin初始化
	GUI_Init();
	WM_MULTIBUF_Enable(1);
	g_hActiveWin = WM_HBKWIN;

//    //显示手标
//	GUI_CURSOR_SetPosition(200, 200);
//	GUI_CURSOR_Show();

	GUI_SetColor(GUI_BLACK);
	GUI_Clear();

	//判断是否已经校准过系数了
	if(MachInfo.touch.flag == TOUCH_INIT_FLAG){
		int PixelX[NUM_CALIB_POINTS];
		int PixelY[NUM_CALIB_POINTS];
		int SamX[NUM_CALIB_POINTS];
		int SamY[NUM_CALIB_POINTS];
		uint8_t i = 0;

		for(i=0;i<NUM_CALIB_POINTS;i++){
			PixelX[i] = MachInfo.touch.pixelX[i];
		}
		for(i=0;i<NUM_CALIB_POINTS;i++){
			PixelY[i] = MachInfo.touch.pixelY[i];
		}
		for(i=0;i<NUM_CALIB_POINTS;i++){
			SamX[i] = MachInfo.touch.samX[i];
		}
		for(i=0;i<NUM_CALIB_POINTS;i++){
			SamY[i] = MachInfo.touch.samY[i];
		}

		//录入校准参数
		GUI_TOUCH_CalcCoefficients(NUM_CALIB_POINTS,PixelX,PixelY,SamX,SamY, LCD_WIDTH_PIXEL, LCD_HIGHT_PIXEL);
	}else{
        //建立坐标系校准转换关系
        Touch_Adjust();
	}

	//初始化文件系统底层，若失败，则直接锁定程序
	FS_LowLevelInit();

	//挂载文件系统，若挂载失败，则直接锁定程序
//    FS_Mount(FS_MOUNT_LOCK);

	//加载开机背景图片到SDRAM(开关机和登录画面，建议使用加载到SDRAM，画面切换更流畅)
    LoadBMP_To_SDRAM(BK_PICTURE_OTHERS_POWER_ON_OFF);

	//加载ICON到SDRAM
	LoadAllICONToSDRAM();

    //显示开机画面
    Show_BK_BMP(BK_SDRAM,BK_PICTURE_OTHERS_POWER_ON_OFF, 0, 0);

	osDelay(20);

    //开LCD背光
    LCD_BL_ON;

//===加载字库===
    SIF_Font_Init();

    //使能UTF-8，便可使用SIF字体
    GUI_UC_SetEncodeUTF8();

	//设置控件全局属性
    GUI_SetDefaultFont(&HZ_SONGTI_16);
	LISTVIEW_SetDefaultFont(&HZ_SONGTI_16);
    BUTTON_SetDefaultFont(&HZ_SONGTI_16);
	HEADER_SetDefaultFont(&HZ_SONGTI_16);
    TEXT_SetDefaultFont(&HZ_SONGTI_16);
    EDIT_SetDefaultFont(&HZ_SONGTI_16);
    DROPDOWN_SetDefaultFont(&HZ_SONGTI_16);
//===============

#if PCBA_CHECK_MAIN_BOARD || PCBA_CHECK_ZJ_BOARD || PCBA_CHECK_CAT || PCBA_CHECK_TOUCH_SCREEN || PCBA_CHECK_MOTO || PCBA_CHECK_PRESSURE_MONITOR || PCBA_CHECK_VALVE_PUMP
		Public_Msg_Init();

		//打开PCBA检验界面
		g_hActiveWin = CreatePCBA_Page();
        LCD_BL_ON;
#else
    //加载其他部分切图到SDRAM
    LoadPartBMP_To_SDRAM();

    //打开登录界面
	g_hActiveWin = CreateLogin_Window();

	//判断是否启动升级流程
	if((MachRunPara.update.nextOpenToStartUpdateFlag == NEXT_OPEN_TO_START_UPDATE_FLAG) && (strlen((char*)MachInfo.labInfo.ucaMachineSN)>=12)){						//判断是否启动升级流程
		if(DialogWin == NULL){
			WM_HideWindow(g_hActiveWin);
			DialogWin = CreateDialogPage();
		}

		//弹窗提示
		DialogPageData.bmpType = BMP_ALARM;
		DialogPageData.confimButt = NO_CONFIM_BUTTON;
		DialogPageData.fun = NULL;
		strcpy(DialogPageData.str,g_ucaLng_START_UPDATE[MachInfo.systemSet.eLanguage]);

		pMsg.MsgId = WM_USER_DATA;
		pMsg.Data.p = &DialogPageData;
		WM_SendMessage(DialogWin,&pMsg);
	}else if((MachInfo.flag.bit.lock == 1) && (strlen((char*)MachInfo.labInfo.ucaMachineSN)>=12)){					//判断是否需要锁机
		if(DialogWin == NULL){
			WM_HideWindow(g_hActiveWin);
			DialogWin = CreateDialogPage();
		}

		//弹窗提示
		DialogPageData.bmpType = BMP_ALARM;
		DialogPageData.confimButt = NO_CONFIM_BUTTON;
		DialogPageData.fun = NULL;
		strcpy(DialogPageData.str,g_ucaLng_LOCK_MACHINE[MachInfo.systemSet.eLanguage]);

		pMsg.MsgId = WM_USER_DATA;
		pMsg.Data.p = &DialogPageData;
		WM_SendMessage(DialogWin,&pMsg);
	}

#endif

	//重复开关机临时任务
#if AUTO_POWER_ONOFF_SELF_CHECK
	{
		osThreadId_t TempTask_AutoPowerOnoffCheckHandle;
		const osThreadAttr_t TempTask_AutoPowerOnoffCheck_attributes = {
		  .name = "TempTask_AutoPowerOnoffCheck",
		  .priority = (osPriority_t) osPriorityLow6,
		  .stack_size = 128*6
		};

		//临时创建一个任务来执行自动的开关机任务
		TempTask_AutoPowerOnoffCheckHandle = osThreadNew(TempTask_AutoPowerOnoffCheck, NULL, &TempTask_AutoPowerOnoffCheck_attributes);
	}
#endif

	//卸载文件系统
//	FS_Unmount();

	ulTick = HAL_GetTick();

    for(;;)
    {
        UI_Msg_Handler();

        if(HAL_GetTick() - ulTick > 20000)//20s
        {
            ulTick = HAL_GetTick();
            if(WM_GetCallback(WM_HBKWIN) == Public_cbBkWin) //当WM_HBKWIN的回调函数未Public_cbBkWin时，才发送更新消息（更新状态栏）
            {
                WM_SendMessageNoPara(WM_HBKWIN, WM_PUBLIC_UPDATE);
            }
        }
        GUI_Delay(20);
    }
  /* USER CODE END UI_FrontEndTask */
}

void UI_BackEndTask(void *argument)
{
  /* USER CODE BEGIN UI_BackEndTask */
    /* Infinite loop */
	extern MachInfo_s MachInfo;

    //设置HGB数字电位器值
    HGB_Gran_Set(HGB_DR_CHANNEL,MachInfo.paramSet.ucHGB_Gain);

    //WBC数字电位器值
    WBC_Gran_Set(WBC_DR_CHANNEL, MachInfo.paramSet.ucWBC_Gain);

	//病人信息结构体初始化
	Patient_Info_Init();

    for(;;)
    {
        BackEnd_Msg_Handler();
        osDelay(1);
    }
  /* USER CODE END UI_BackEndTask */
}

/* USER CODE BEGIN Header_AlgoTask */
/**
* @brief Function implementing the Algo thread.
* @param argument: Not used
* @retval None
*/

/*
*   挂起algo任务
*/
void Disable_Algo_Task(void)
{
//	printf("suspend algo\r\n");
    osSemaphoreAcquire(xSema_Count_Key, 0); //挂起前清除信号量
    osThreadSuspend(AlgoHandle);
}

/*
*   恢复algo任务
*/
void Enable_Algo_Task(Bool eFlag)
{
//	printf("resume algo\r\n");

    //true清信号量，false不清除
    if(TRUE == eFlag)
    {
        osSemaphoreAcquire(xSema_Count_Key, 0); //挂起前清除信号量
    }
    osThreadResume(AlgoHandle);
}

/* USER CODE END Header_AlgoTask */
void AlgoTask(void *argument)
{
  /* USER CODE BEGIN AlgoTask */

  extern MachInfo_s MachInfo;
  extern __IO uint8_t g_Count_Key;
  extern __IO osSemaphoreId_t xSema_Count_Key;
  extern __IO Bool g_bAlgoTask_Flag;

  __IO uint32_t ulCountMode;

    for(;;)
    {
        osSemaphoreAcquire(xSema_Count_Key, osWaitForever);

        ulCountMode = Get_CountMode_Info()->ulCountMode;

        if(PANEL_LED_STATUS_ERROR ==  g_ePanel_LED_Status)
        {
            //开机自检存在故障（影响计数），需先清除故障，再计数
            WM_SendMessageNoPara(g_hActiveWin, WM_ANALYSISI_ERROR_COUNT_NOT_ALLOW);
            ulCountMode = COUNT_MODE_INVALIDE;
        }else{
            //计数开始
            g_CountHandle_Status = 1;
        }

        //
        switch(ulCountMode)
        {
            case COUNT_MODE_NORMAL:
            {
                //正常计数流程
                Count_Exec(TEST_PROJECT_WBC_HGB, COUNT_MODE_NORMAL);
            }
            break;
            case COUNT_MODE_QC_NORMAL:
            {
                //质控、正常计数流程
                QC_Count_Exec(TEST_PROJECT_WBC_HGB, COUNT_MODE_QC_NORMAL);
            }
            break;
            case COUNT_MODE_QC_OUTSIDE:
            {
                QC_Count_Exec(TEST_PROJECT_WBC_HGB, COUNT_MODE_QC_OUTSIDE);
                osSemaphoreRelease(xSema_Count_Key); //执行下一次
            }
            break;
            case COUNT_MODE_QC_INNER_AUTO:
            {
                QC_Count_Exec(TEST_PROJECT_WBC_HGB, COUNT_MODE_QC_INNER_AUTO);
                osSemaphoreRelease(xSema_Count_Key); //执行下一次
            }
            break;
            case COUNT_MODE_RE_USE:
            {
                //测试模式（定时采样，不检测定量电极触发,即：计数池重复使用模式）
                osDelay(Get_CountMode_Info()->ulReUseMode_Delay*1000);
                Count_Exec(TEST_PROJECT_WBC_HGB, COUNT_MODE_RE_USE);
            }
            break;
            case COUNT_MODE_SIGNAL_SRC:
            {
                //信号源模式
                Count_Exec(TEST_PROJECT_WBC_HGB, COUNT_MODE_SIGNAL_SRC);
            }
            break;
            case COUNT_MODE_SIMULATION_SIGNAL_INNER:
            {
                //工装信号仿真模拟测试,-->单次操作：采集内部工装信号。并通过算法计算。保存对应数据日志。刷新数据到样本分析界面。界面操作提示
                Count_Exec(TEST_PROJECT_WBC_HGB, COUNT_MODE_SIMULATION_SIGNAL_INNER);//COUNT_MODE_SIMULATION);
                //断开板载工装信号
                COUNT_SIGNAL_SW_OFF;
                //关闭信号
                Count_Signal_Stop();
            }
            break;
            case COUNT_MODE_SIMULATION_SIGNAL_INNER_AUTO:
            {
                //内部工装信号仿真模拟全流程测试-->重复操作：采集内部工装信号。并通过算法计算。保存对应数据日志。刷新数据到样本分析界面。（无界面操作提示）
                Count_Exec(TEST_PROJECT_WBC_HGB, COUNT_MODE_SIMULATION_SIGNAL_INNER_AUTO);
                //断开板载工装信号
                //COUNT_SIGNAL_SW_OFF;
                //关闭信号
                //Count_Signal_Stop();
                osSemaphoreRelease(xSema_Count_Key); //执行下一次
            }
            break;
            case COUNT_MODE_SIMULATION_SIGNAL_OUTSIDE:
            {
                //外部工装信号仿真模拟测试-->单次操作：采集外部工装信号。并通过算法计算。保存对应数据日志。刷新数据到样本分析界面。界面操作提示
                Count_Exec(TEST_PROJECT_WBC_HGB, COUNT_MODE_SIMULATION_SIGNAL_OUTSIDE);
            }
            break;
            case COUNT_MODE_SIMULATION_SIGNAL_OUTSIDE_AUTO:
            {
                if(Get_CountMode_Info()->ulOutGZ_CountNum > 0)
                {
                    //外部工装信号仿真模拟测试,-->重复操作：采集外部工装信号。并通过算法计算。保存对应数据日志。刷新数据到样本分析界面。（无界面操作提示）
                    Count_Exec(TEST_PROJECT_WBC_HGB, COUNT_MODE_SIMULATION_SIGNAL_OUTSIDE_AUTO);
                    Get_CountMode_Info()->ulOutGZ_CountNum--;
                    osSemaphoreRelease(xSema_Count_Key); //执行下一次
                }
            }
            break;

			//质检--WBC测试
			case COUNT_MODE_ZJ_WBC_TEST:
			{
				ZJ_WBCGZTest();
			}break;

			//质检--HGB空白测试
			case COUNT_MODE_ZJ_HGB_KB:
			{
				ZJ_HGB_KB();
			}break;

			//质检--HGB精密度测试
			case COUNT_MODE_ZJ_HGB_JMD:
			{
				ZJ_HGB_JMD();
			}break;

			//质检--HGB校准1
			case COUNT_MODE_ZJ_HGB_JZ_1:
			{
				ZJ_HGB_JZ(ZJ_HGBJZ_1);
			}break;

			//质检--HGB校准2
			case COUNT_MODE_ZJ_HGB_JZ_2:
			{
				ZJ_HGB_JZ(ZJ_HGBJZ_2);
			}break;

			//质检--HGB校准3
			case COUNT_MODE_ZJ_HGB_JZ_3:
			{
				ZJ_HGB_JZ(ZJ_HGBJZ_3);
			}break;

			//质检--HGB线性1
			case COUNT_MODE_ZJ_HGB_XX_1:
			{
				ZJ_HGB_XX(ZJ_HGBXX_1);
			}break;

			//质检--HGB线性2
			case COUNT_MODE_ZJ_HGB_XX_2:
			{
				ZJ_HGB_XX(ZJ_HGBXX_2);
			}break;

			//质检--HGB线性3
			case COUNT_MODE_ZJ_HGB_XX_3:
			{
				ZJ_HGB_XX(ZJ_HGBXX_3);
			}break;

			//质检--HGB线性4
			case COUNT_MODE_ZJ_HGB_XX_4:
			{
				ZJ_HGB_XX(ZJ_HGBXX_4);
			}break;

			//质检--HGB线性5
			case COUNT_MODE_ZJ_HGB_XX_5:
			{
				ZJ_HGB_XX(ZJ_HGBXX_5);
			}break;

			//质检--准确度1
			case COUNT_MODE_ZJ_HGB_ZQD_1:
			{
				ZJ_HGB_ZQD(ZJ_HGBZQD_1);
			}break;

			//质检--准确度2
			case COUNT_MODE_ZJ_HGB_ZQD_2:
			{
				ZJ_HGB_ZQD(ZJ_HGBZQD_2);
			}break;

			//质检--准确度3
			case COUNT_MODE_ZJ_HGB_ZQD_3:
			{
				ZJ_HGB_ZQD(ZJ_HGBZQD_3);
			}break;

            default:break;
        }

        //计数结束，指示灯停止闪耀
        g_CountHandle_Status = 0;
        //
        if(COUNT_MODE_SIMULATION_SIGNAL_OUTSIDE_AUTO != ulCountMode && COUNT_MODE_SIMULATION_SIGNAL_INNER_AUTO != ulCountMode && COUNT_MODE_QC_INNER_AUTO != ulCountMode && COUNT_MODE_QC_NORMAL != ulCountMode)
        {
			Disable_Algo_Task();
        }

        osDelay(1);
    }
  /* USER CODE END AlgoTask */
}

/************************ (C) COPYRIGHT STMicroelectronics *****END OF FILE****/
