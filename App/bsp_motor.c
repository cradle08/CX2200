#include "main.h"
#include "stm32f4xx_hal_tim.h"
#include "bsp_outin.h"
#include "tim.h"
#include "bsp_motor.h"
#include "cmsis_os2.h"



/****************************************************************/

//-----------------------------------------------------------------------------------------
// global variable definition

// 1) Static variable，store in flash, to reduce the memory size, the table only records 
//    the corresponding frequence which ignore the frequency divider.
// 2) Attention: if the frequence of the timer is higher, the reloaded value is discreter.
uint16_t const m_acTimerLoad[8000] =     // frep:(50 ~ 3150) * 8     
#if 0  // for overflow value
//  reserved 
#else  // for comparing value
{   // --- 9MHz * 1, Start Creating Array, divice : 16 ---  
	0xFFFF, 0xFFFF, 0xFFFF, 0xFFFF, 0xFFFF, 0xFFFF, 0xFFFF, 0xFFFF, 0xFFFF, 0xFFFF, 
	0xE666, 0xD174, 0xC000, 0xB13B, 0xA492, 0x9999, 0x9000, 0x8787, 0x8000, 0x7943, 
	0x7333, 0x6DB6, 0x68BA, 0x642C, 0x6000, 0x5C28, 0x589D, 0x5555, 0x5249, 0x4F72, 
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	0x0049, 0x0049, 0x0049, 0x0049, 0x0049, 0x0049, 0x0049, 0x0049, 0x0049, 0x0049
};

#endif

#define MTx_FREQ_OFFSET_BITS(ch)   4 // 2 ^ 4 = 16  

// parameters and status
__IO  MotorStatus_t  g_tMotorStatus[MOTOR_END]; // status
__IO  MotorPara_t    g_tMotorPara[MOTOR_END];   // paramenters



// direction position
//static uint32_t const m_acnDirPos[MOTOR_END] =
//{
//    MOTOR_DIR_IN,
//    MOTOR_DIR_IN,
//};
//// direction negation
//static uint32_t const m_acnDirNeg[MOTOR_END] = 
//{
//	 MOTOR_DIR_OUT,
//	 MOTOR_DIR_OUT,
//};

uint32_t const  MTx_FreqMin[MOTOR_END] =
{
	0,
	0,
};
uint32_t const MTx_FreqMax[MOTOR_END] =  // 32 * 8000
{
	256000,
	256000,
};
uint32_t const MTx_FreqInc[MOTOR_END] =
{
	4000,
	4000,
};
uint32_t const MTx_Distance[MOTOR_END] =
{
	1000000,
	1000000,
};


// Motor0(OUTIN) = htim3
// Motor1(CLAMP) = htim2
TIM_HandleTypeDef  *MTx_Timer[MOTOR_END] = {0};

#define MTx_VALUE_FREQ_MIN(ch)             MTx_FreqMin[ch]            
// 2) the maximum of the motor's frequence
#define MTx_VALUE_FREQ_MAX(ch)             MTx_FreqMax[ch]  // 32 * 8000
// 3) the maximum increment of the motor's frequence
#define MTx_VALUE_FREQ_INC(ch)             MTx_FreqInc[ch]
// 4) the maximum  steps of the total run(rectilinear movement or circular movement)
#define MTx_VALUE_DISTANCE_MAX(ch)         MTx_Distance[ch] 





//// 1) timer init
//#define MTx_TIMER_INIT(ch)               {PF_InitMotorTimer(ch);}
//// 2) enable the interrupt 
//#define MTx_TIMER_INTERRUPT_ON(ch)         {TIM_ITConfig(MTx_Timer[ch], TIM_IT_Update, ENABLE);}
#define MTx_TIMER_INTERRUPT_ON(ch)         {__HAL_TIM_ENABLE_IT(MTx_Timer[ch], TIM_IT_UPDATE);}
//// 3) disable the interrupt
//#define MTx_TIMER_INTERRUPT_OFF(ch)        {TIM_ITConfig(MTx_Timer[ch], TIM_IT_Update, DISABLE);}
#define MTx_TIMER_INTERRUPT_OFF(ch)        {__HAL_TIM_DISABLE_IT(MTx_Timer[ch], TIM_IT_UPDATE);}
//// 4) clean the flag of interrupt
//#define MTx_TIMER_INTERRUPT_FLAG_CLEAR(ch) {TIM_ClearITPendingBit(MTx_Timer[ch] , TIM_FLAG_Update);}
#define MTx_TIMER_INTERRUPT_FLAG_CLEAR(ch) {__HAL_TIM_CLEAR_FLAG(MTx_Timer[ch] , TIM_FLAG_UPDATE);}
//// 5) counting is on 
//#define MTx_TIMER_COUNT_ON(ch)             {TIM_Cmd(MTx_Timer[ch], ENABLE);} 
//#define MTx_TIMER_COUNT_ON(ch)             {__HAL_TIM_ENABLE(MTx_Timer[ch]);} 
#define MTx_TIMER_COUNT_ON(ch)             {HAL_TIM_Base_Start_IT(MTx_Timer[ch]);} 

//// 6) counting is off
//#define MTx_TIMER_COUNT_OFF(ch)            {TIM_Cmd(MTx_Timer[ch], DISABLE);}
//#define MTx_TIMER_COUNT_OFF(ch)            {__HAL_TIM_DISABLE(MTx_Timer[ch]);}
#define MTx_TIMER_COUNT_OFF(ch)            {HAL_TIM_Base_Stop_IT(MTx_Timer[ch]);}
               
//// 7) change the reloaded value and don't effect the counter's value
//#define MTx_TIMER_LOAD(ch, VALUE)          {TIM_SetAutoreload(MTx_Timer[ch], (VALUE));} // {TIM_SetCounter(MTx_Timer[ch], (VALUE));}  
#define MTx_TIMER_LOAD(ch, VALUE)          {__HAL_TIM_SET_AUTORELOAD(MTx_Timer[ch], (VALUE));} // {TIM_SetCounter(MTx_Timer[ch], (VALUE));}  




/*
*   电机 运用延时函数，根据模块不同的运行方式，选择不同延时方式,  
*/
void Motor_Delay(MotorMode_e eMode, uint32_t ulTime)
{   
    if(MOTOR_MODE_NORMAL == eMode)
    {
        //非堵塞延时，
        osDelay(ulTime);
    }else if(MOTOR_MODE_COUNT == eMode){
        //堵塞延时
        HAL_Delay(ulTime);
    }
}



/*
* Motor Timer struct Init, must callback after TIM2,TME3 Init
*/
void MTx_Timer_Init(void)
{  
    extern __IO  MotorStatus_t  g_tMotorStatus[MOTOR_END];
    uint8_t ucIndex  = 0;
    
    //
    MTx_Timer[MOTOR_OUTIN] = &htim3;
    MTx_Timer[MOTOR_CLAMP] = &htim2;
    
    //
    Motor_Enable(MOTOR_OUTIN, FALSE);
    Motor_Enable(MOTOR_CLAMP, FALSE);
    
    //
    for(ucIndex = 0; ucIndex < MOTOR_END; ucIndex++)
    {
        //完成状态
         memset((void*)&g_tMotorStatus[ucIndex], 0, sizeof(MotorStatus_t));
        g_tMotorStatus[ucIndex].eFinish = TRUE;
    }
}


/*
* 电机驱动 状态设置
*/
uint8_t  MTx_DriverEnable(Motor_e eMotor, Bool eAble)
{
    // check
    if(eMotor >= MOTOR_END)
    {
		return FEED_BACK_ERROR;
	}
	
    //使能对应电机
    Motor_Enable(eMotor, eAble);
    //打开或关闭对应定时器
	if(eMotor == MOTOR_OUTIN)
	{
		if(FALSE == eAble)
		{
			MTx_TIMER_COUNT_OFF(eMotor);
		}else{
			MTx_TIMER_COUNT_ON(eMotor);
		}	
	}else if(eMotor == MOTOR_CLAMP){
		if(FALSE == eAble)
		{
			MTx_TIMER_COUNT_OFF(eMotor);
		
		}else{
			MTx_TIMER_COUNT_ON(eMotor);
		}			
	}				
    return FEED_BACK_SUCCESS;
}



//
uint8_t  MV_InitPara(Motor_e eMotor, uint32_t nFreqMin, uint32_t nFreqMax, uint32_t nFreqInc, uint32_t nFreqSam)
{
    // range check 
    if(eMotor >= MOTOR_END)
    {
        return FEED_BACK_ERROR;
	}
    
	// parameters check
	if( (0 == nFreqSam) || (0 == nFreqInc) || (nFreqMin > nFreqMax) || (nFreqInc > nFreqMax))
	{
        return FEED_BACK_ERROR;
	}
		
	// record the motor's parameters
    //g_tMotorPara[eMotor].nFreqMin   = nFreqMin;
	//g_tMotorPara[eMotor].nFreqMax   = nFreqMax;
	//g_tMotorPara[eMotor].nFreqInc   = nFreqInc;
    //g_tMotorPara[eMotor].nFreqSam   = nFreqSam;
	
	//-----------------------------------
    // 2. checking the parameters 
    // 1) error parameters of global
    if( (0 == MTx_VALUE_FREQ_INC(eMotor)) ||      
		(MTx_VALUE_FREQ_MIN(eMotor) > MTx_VALUE_FREQ_MAX(eMotor)) ||
		(MTx_VALUE_FREQ_INC(eMotor) > MTx_VALUE_FREQ_MAX(eMotor)) )
    {
        return FEED_BACK_ERROR;  // the protected parameters set by user above are wrong
	}
    // 2) error parameters of movement
    if( // (0 == nFreqInc) ||     // attention: can be equal to "0"
		(0 == nFreqSam) ||
		(0 == nFreqInc) ||
		(nFreqMin > nFreqMax) ||
		(nFreqInc > nFreqMax) ||
		(nFreqMin > MTx_VALUE_FREQ_MAX(eMotor)) ||
		(nFreqMax < MTx_VALUE_FREQ_MIN(eMotor)) )
    {
        return FEED_BACK_ERROR;
	}
	
    // init data
	memset((char*)&g_tMotorStatus[eMotor], 0, sizeof(g_tMotorStatus[eMotor]));
	memset((char*)&g_tMotorPara[eMotor], 0, sizeof(g_tMotorPara[eMotor]));
	// 1) min
	if(nFreqMin < MTx_VALUE_FREQ_MIN(eMotor))
	{
        g_tMotorStatus[eMotor].nFreqMin = MTx_VALUE_FREQ_MIN(eMotor);	
	}		
	else
	{
        g_tMotorStatus[eMotor].nFreqMin = nFreqMin;
	}
	// 2) max
	if(nFreqMax > MTx_VALUE_FREQ_MAX(eMotor))
	{
        g_tMotorStatus[eMotor].nFreqMax = MTx_VALUE_FREQ_MAX(eMotor);
	}
	else
	{
        g_tMotorStatus[eMotor].nFreqMax = nFreqMax;
	}
	// 3) inc
	if(nFreqInc > MTx_VALUE_FREQ_INC(eMotor))
	{
        g_tMotorStatus[eMotor].nFreqInc = MTx_VALUE_FREQ_INC(eMotor);
	}
	else
	{
        g_tMotorStatus[eMotor].nFreqInc = nFreqInc;
	}
	// 4) sam
	g_tMotorStatus[eMotor].nFreqSam = nFreqSam;

    return FEED_BACK_SUCCESS; 
}



//
uint8_t  MV_Move(Motor_e eMotor, uint32_t nSteps, MotorDir_e eDir)
{
	__IO uint8_t i = 0, nVal = 0;
	__IO uint32_t   nValue = 0;
	__IO uint32_t   nBase  = 0;
	__IO uint32_t   nAllow = 0;
	__IO uint32_t   nAcc   = 0;
	__IO uint32_t   nEqu   = 0;
	
	//------------------------------------------
    // 1. checking 
    // range check 
    if(eMotor >= MOTOR_END)
    {
        //g_tMotorStatus[eMotor].eFinish = TRUE;
        return FEED_BACK_ERROR;
	}
	// parameters check
    if( (0 == g_tMotorStatus[eMotor].nFreqSam) ||
		(0 == g_tMotorStatus[eMotor].nFreqInc) ||
		(g_tMotorStatus[eMotor].nFreqMin > g_tMotorStatus[eMotor].nFreqMax) ||
		(g_tMotorStatus[eMotor].nFreqInc > g_tMotorStatus[eMotor].nFreqMax) )
	{
	    g_tMotorStatus[eMotor].eFinish = TRUE;
        return FEED_BACK_ERROR;
	}
	
	//------------------------------------------
    // 2. record the status of the motor
    g_tMotorStatus[eMotor].eDir    		    = eDir;
    g_tMotorStatus[eMotor].eFinish 		    = FALSE;
    g_tMotorStatus[eMotor].nSteps		    = nSteps;   
	g_tMotorStatus[eMotor].bAble   		    = TRUE;
	g_tMotorStatus[eMotor].nStepsExecuted   = 0;
	if(eMotor == MOTOR_OUTIN)
	{
        if(eDir == MOTOR_DIR_IN) // in
        {
            g_tMotorStatus[eMotor].nOCIndex = OC_INDEX_OUTIN_IN;
            g_tMotorStatus[eMotor].nOCStatus =  OC_Status(OC_INDEX_OUTIN_IN);
            
        }else if(eDir == MOTOR_DIR_OUT){ // out
            g_tMotorStatus[eMotor].nOCIndex = OC_INDEX_OUTIN_OUT;
            g_tMotorStatus[eMotor].nOCStatus =  OC_Status(OC_INDEX_OUTIN_OUT);
        }
	}else if(eMotor == MOTOR_CLAMP){
		
        if(eDir == MOTOR_DIR_IN) // in
        {
            g_tMotorStatus[eMotor].nOCIndex = OC_INDEX_CLAMP_IN;
            g_tMotorStatus[eMotor].nOCStatus = OC_Status(OC_INDEX_CLAMP_IN);
            
        }else if(eDir == MOTOR_DIR_OUT){ // out
            
            g_tMotorStatus[eMotor].nOCIndex = OC_INDEX_CLAMP_OUT;
            g_tMotorStatus[eMotor].nOCStatus = OC_Status(OC_INDEX_CLAMP_OUT);
        }
	}
    // 4. calculate the curve of the movement according to the parameters 
    // 1) stairs needed of two ways
    nBase  = (uint32_t)( (g_tMotorStatus[eMotor].nFreqMax - g_tMotorStatus[eMotor].nFreqMin) / g_tMotorStatus[eMotor].nFreqInc);     
    nAllow = (uint32_t)( (nSteps / 2) / g_tMotorStatus[eMotor].nFreqSam );
    // 2) select the minimum
    if(nBase >= nAllow)
    {
        nAcc = nAllow;
    }
    else
    {
        nAcc = nBase;
    }
    // 3) the steps of phase speed-up or phase speed-reduce
    nValue = (uint32_t)( nAcc * g_tMotorStatus[eMotor].nFreqSam );
    nAcc   = nValue;
    // 4) the steps of phase speed-keep
    nValue = (uint32_t)( nAcc * 2 );
    if(nValue > nSteps)
    {
        nAcc = 0;
        nEqu = nSteps;
    }
    else
    {
        // keep value "nACC"
        nEqu = nSteps - nValue;
    }
    // 5) attention: disable the interrupt of the timer 
    MTx_DriverEnable(eMotor, FALSE);
    // 6) generating the parametes for a new movement
    g_tMotorStatus[eMotor].nStepsAcc   = nAcc;
    g_tMotorStatus[eMotor].nStepsDec   = nAcc;
    g_tMotorStatus[eMotor].nStepsEqu   = nEqu;
    g_tMotorStatus[eMotor].nSteps	   = nSteps;
    g_tMotorStatus[eMotor].eDir  	   = eDir;
    g_tMotorStatus[eMotor].ePhase      = Motor_Phase_IDLE;
    //
    g_tMotorStatus[eMotor].nCurFreq  = g_tMotorStatus[eMotor].nFreqMin;
    nValue = g_tMotorStatus[eMotor].nCurFreq >> MTx_FREQ_OFFSET_BITS(chIndex);
    g_tMotorStatus[eMotor].nTimeLoad = m_acTimerLoad[nValue];

   // 7) enable the timer 
   MTx_DriverEnable(eMotor, TRUE);

#if 0 // MTx_WAVE_OUTPUT(chIndex)	

	printf(" --- motor %d --- FreqMin:%d, nFreqMax:%d, Inc:%d, Sam:%d, Step:%d, Dir:%d",\
			chIndex, (int)nFreqMin, (int)nFreqMax, (int)nFreqInc, (int)nFreqSam, (int)nSteps, (int)eDir);
	printf( "-nAcc:%u -nDec:%u -nEqu:%u -nTotal:%u -Dir:%u-CurFreq:%d,TimeLoad:%d ",
	       (int)nAcc, (int)nAcc, (int)nEqu, (int)nSteps, (int)eDir, (int)m_atMotorControl[chIndex].nCurFreq, (int)m_atMotorControl[chIndex].nTimeLoad); 
#endif
	
	return FEED_BACK_SUCCESS;
}




/*
*   低级停止
*/
uint8_t  MV_Stop(Motor_e eMotor)
{
	// range check 
    if(eMotor >= MOTOR_END)
    {
        return FEED_BACK_ERROR;
	}

    g_tMotorStatus[eMotor].eFinish = TRUE;
	
	//MTx_TIMER_INTERRUPT_OFF(eMotor); // close irq
	MTx_DriverEnable(eMotor, FALSE);
	Motor_Set_Current(MOTOR_CURRENT_VALUE_START);
    return FEED_BACK_SUCCESS;
}




/* 参数chIndex为通道号 */
/* 参数nDlyMs为等待的最大超时时间，但bDlyType为TRUE时有效 */
/* 参数bDlyType为是否启用超时判断 */
uint8_t  MTx_Wait(Motor_e eMotor, uint32_t nTimeout, Bool bFlag)
{
    __IO uint8_t   chReturn = FEED_BACK_SUCCESS;
	__IO uint32_t  nCount   = 0;

    // check
    if(eMotor >= MOTOR_END)
    {
		return FEED_BACK_ERROR;
	}
	//
	if(FALSE == bFlag)
	{
	    while(g_tMotorStatus[eMotor].nStepsExecuted >= g_tMotorStatus[eMotor].nSteps)
	    {
			// 
	        //HAL_Delay(1);      // 2ms  
		}
	}
	else
	{
	    nCount = 0;
	    while(g_tMotorStatus[eMotor].nStepsExecuted >= g_tMotorStatus[eMotor].nSteps)
	    {
	        // 
	        //HAL_Delay(1);      // 2ms    
			//	
		    nCount += 1;         // attention: + 2
		    if(nCount >= nTimeout) // overtime
		    {
			    chReturn = FEED_BACK_FAIL;  
				//
			    break; 
		    } 
	    }
	} 
	MV_Stop(eMotor);
	
	return chReturn;
}



/*
*   获取已经执行的步数
*/
uint32_t MV_GetStepsExecuted(Motor_e eMotor)
{
    // 
    if(eMotor >= MOTOR_END)
    {
        //*pnSteps = 0;
        return 0xFFFF;
	}

	return g_tMotorStatus[eMotor].nStepsExecuted;
}




/*
*   判断电机是否结束
*/
Bool  MV_IsFinished(Motor_e eMotor)
{
    // range check 
    if(eMotor >= MOTOR_END)
    {
        return FALSE;
	}
	
    return g_tMotorStatus[eMotor].eFinish;
}





/*
*   
*/
uint8_t  MV_IsrMoveHandling(void)
{
	return 0;
}





//// Timer1 IRQ
//void IRQ_Motor3(void)
//{
//     MTx_PWM_ISR(Motor_Y);//MTx_PWM_ISR(EN_Motor3);

//    return;
//}

//// Timer8 IRQ
//void IRQ_Motor4(void)
//{
//    MTx_PWM_ISR(Motor_X);//MTx_PWM_ISR(EN_Motor3);
//    return;
//}


void MTx_IoMinitor_Disnable(Motor_e  eMotor)
{
	g_tMotorStatus[eMotor].bAble = FALSE;
}

void MTx_IoMinitor_Enable(Motor_e eMotor)
{
	g_tMotorStatus[eMotor].bAble = TRUE;
}


void MTx_IoMinitor(Motor_e eMotor)
{
    __IO uint8_t  chCurLevel;

    // check
    if(eMotor >= MOTOR_END)
    {
		return;  // error
	}
	
	// 1. for home-OC input
    if(FALSE != g_tMotorStatus[eMotor].bAble)
	{
	    //-----------------------------------------
	    // 1) get the current level
        chCurLevel = OC_Status(g_tMotorStatus[eMotor].nOCIndex);
		//-----------------------------------------
		// 2) excute the special movement according to the status of the level's change 
		if(SET == chCurLevel) // OC touch
		{
			Delay_US(500);Delay_US(500);
//			Delay_US(500);Delay_US(500);
			chCurLevel = OC_Status(g_tMotorStatus[eMotor].nOCIndex);
			if(SET == chCurLevel) //if(g_atMotorStatus[eMotor].nOCStatus != chCurLevel)
			{ 
				// stop immediately
				//if(0 == g_atMotorStatus[eMotor].nStepsSlow) 
				//{
					g_tMotorStatus[eMotor].nStepsAcc   = 0;
					g_tMotorStatus[eMotor].nStepsEqu   = 0;
					g_tMotorStatus[eMotor].nStepsDec   = 0;
					g_tMotorStatus[eMotor].nSteps = 0;
				//}

				//-----------------------------------------
				// 3) attention: only for one time !!!
				g_tMotorStatus[eMotor].bAble = FALSE;
				g_tMotorStatus[eMotor].eFinish = TRUE;
				g_tMotorStatus[eMotor].nOCStatus = chCurLevel;
				g_tMotorStatus[eMotor].ePhase = Motor_Phase_FIN;
			}
		} // end of if
	}
	// 2. for other's IO input
	return;
}	





//-----------------------------------------------------------------------------------------
void MTx_PWM_ISR(Motor_e eMotor)  // _USE  MTx_TIMER_INTERRUPT_INDEX
{
    // static variables
    static __IO uint32_t  s_nTheSameStepsCount = 0;
	static __IO uint32_t  s_nTimerLoadedIndex  = 0;

    // check
    if(eMotor >= MOTOR_END)
    {
		return;   // error
	}
	
	//------------------------------------------------------------
	// 1. for testing, output the curve of the movement
//#if MTx_WAVE_OUTPUT(chIndex)
	// __IO char XRAM_ str[50];
//#endif
    //------------------------------------------------------------
	// 2. shut down the timer
	MTx_TIMER_INTERRUPT_OFF(eMotor);   // no nestification is allowed
    MTx_TIMER_INTERRUPT_FLAG_CLEAR(eMotor); // clean the interrupt event

    //------------------------------------------------------------
    //************************************************************
	// 3. PWM-processing
	//MTx_TIMER_LOAD(eMotor, g_tMotorStatus[eMotor].nTimeLoad);
	MTx_TIMER_LOAD(eMotor, g_tMotorStatus[eMotor].nTimeLoad*1.8); // 1.4-6, 1.6-7, 1.8-8, 2.0-0


	// 1) phase changing
	switch(g_tMotorStatus[eMotor].ePhase)
	{
	    //--
        case Motor_Phase_IDLE:
		{
            if(g_tMotorStatus[eMotor].nSteps > 0) // check 
            {
                //
                Motor_Set_Dir(eMotor, g_tMotorStatus[eMotor].eDir);
				g_tMotorStatus[eMotor].ePhase = Motor_Phase_ACC; // Motor_Phase_LOAD -> Motor_Phase_ACC
				s_nTheSameStepsCount             = 0;
				Motor_Set_Current(MOTOR_CURRENT_VALUE_START);
				// don't break out "switch" and continue
			}
			else
			{
				MTx_DriverEnable(eMotor, FALSE);  // stop immediately
				g_tMotorStatus[eMotor].eFinish = TRUE;
				Motor_Set_Current(MOTOR_CURRENT_VALUE_STOP);
                break;  // break out "switch"
			}
		}
#if 0		
		//--
		case Motor_Phase_LOAD:
		{
            m_atMotorControl[chIndex].nCurFreq  = m_atMotorControl[chIndex].nFreqMin;
			s_nTimerLoadedIndex       = m_atMotorControl[chIndex].nCurFreq >> MTx_FREQ_OFFSET_BITS(chIndex);
			m_atMotorControl[chIndex].nTimeLoad = m_acTimerLoad[s_nTimerLoadedIndex];
			m_atMotorControl[chIndex].ePhase    = Motor_Phase_ACC;	 		  
            s_nTheSameStepsCount      = 0;
			// don't break out "switch" and continue
		}
#endif		
		//--
		case Motor_Phase_ACC:
		{
            if(g_tMotorStatus[eMotor].nStepsAcc > 0)
            {
                // a new pulse of PWM 
                Motor_PWM_High(eMotor); //MTx_OUT_PULSE_HIGH(eMotor);
				// the end of a frequence-stair 
				if(s_nTheSameStepsCount >= g_tMotorStatus[eMotor].nFreqSam)
				{
				    // reset
                    s_nTheSameStepsCount      = 0;
					// increase 
                    g_tMotorStatus[eMotor].nCurFreq += g_tMotorStatus[eMotor].nFreqInc;
					if(g_tMotorStatus[eMotor].nCurFreq > g_tMotorStatus[eMotor].nFreqMax) // protect
					{
                        g_tMotorStatus[eMotor].nCurFreq = g_tMotorStatus[eMotor].nFreqMax;
					}
					else
					{
                        // keep
					}
                    // get the timer reloaded value
    			    s_nTimerLoadedIndex       = g_tMotorStatus[eMotor].nCurFreq >> MTx_FREQ_OFFSET_BITS(chIndex);  
   	                g_tMotorStatus[eMotor].nTimeLoad = m_acTimerLoad[s_nTimerLoadedIndex]; // mapping   
				}
                // set the timer's reloaded-value
			    // MTx_TIMER_LOAD(chIndex, m_atMotorControl[chIndex].nTimeLoad);
	    	    // counting
			    g_tMotorStatus[eMotor].nStepsAcc    	-= 1;
				g_tMotorStatus[eMotor].nSteps			-= 1;	//  g_tMotorStatus[eMotor].nStepsTotal		-= 1;
				g_tMotorStatus[eMotor].nStepsExecuted  += 1;
			    // add 1
			    s_nTheSameStepsCount++;

			    break;  // break out for next pulse		
			}
			else
			{
			    g_tMotorStatus[eMotor].nCurFreq += g_tMotorStatus[eMotor].nFreqInc;
				if(g_tMotorStatus[eMotor].nCurFreq > g_tMotorStatus[eMotor].nFreqMax) // protect
				{
                    g_tMotorStatus[eMotor].nCurFreq = g_tMotorStatus[eMotor].nFreqMax;
				}
				else
				{
                    // keep
				}
				s_nTimerLoadedIndex                 = g_tMotorStatus[eMotor].nCurFreq >> MTx_FREQ_OFFSET_BITS(chIndex);  
   	            g_tMotorStatus[eMotor].nTimeLoad = m_acTimerLoad[s_nTimerLoadedIndex]; // mapping 				// 
				// 
				g_tMotorStatus[eMotor].ePhase    = Motor_Phase_EQU;  
				if(MOTOR_DIR_OUT == g_tMotorStatus[eMotor].eDir) 
                {// motor out
                    Motor_Set_Current(MOTOR_CURRENT_VALUE_START);
				}
				else 
				{ // motor in
                    Motor_Set_Current(MOTOR_CURRENT_VALUE_RUN);
				}
			    s_nTheSameStepsCount                = 0;			
			    // don't break out "switch" and continue
			}
		}
		//--
		case Motor_Phase_EQU:
		{
            if(g_tMotorStatus[eMotor].nStepsEqu > 0)
    		{
    		    // a new pulse of PWM 
                Motor_PWM_High(eMotor); //MTx_OUT_PULSE_HIGH(eMotor);    		    	
    			// keep the timer's reloaded-value
			    // MTx_TIMER_LOAD(m_atMotorControl[chIndex].nTimeLoad);   
    			// counting
    			g_tMotorStatus[eMotor].nStepsEqu   	    -= 1;
    			g_tMotorStatus[eMotor].nSteps		    -= 1;
				g_tMotorStatus[eMotor].nStepsExecuted   += 1;
				
    			break;  // break out for next pulse	
    		}
			else
			{
                g_tMotorStatus[eMotor].ePhase        = Motor_Phase_DEC;  
			    s_nTheSameStepsCount                 = 0;
				 Motor_Set_Current(MOTOR_CURRENT_VALUE_START);
			    // don't break out "switch" and continue
			}
		}
		//--
		case Motor_Phase_DEC:
		{
            if(g_tMotorStatus[eMotor].nStepsDec > 0)
     		{   
     		    // a new pulse of PWM 
                Motor_PWM_High(eMotor); //MTx_OUT_PULSE_HIGH(eMotor);  		    
     			if(s_nTheSameStepsCount >= g_tMotorStatus[eMotor].nFreqSam)
     			{
     			    // reset
     			    s_nTheSameStepsCount      = 0;
					// reduce 
     				if(g_tMotorStatus[eMotor].nCurFreq >= (g_tMotorStatus[eMotor].nFreqInc + g_tMotorStatus[eMotor].nFreqMin) ) // protect  
     				{
                        g_tMotorStatus[eMotor].nCurFreq -= g_tMotorStatus[eMotor].nFreqInc;
     				} 
					else
					{
                        // keep
					}
         			// get the timer reloaded value
         			s_nTimerLoadedIndex       = g_tMotorStatus[eMotor].nCurFreq >> MTx_FREQ_OFFSET_BITS(chIndex);     
        	        g_tMotorStatus[eMotor].nTimeLoad = m_acTimerLoad[s_nTimerLoadedIndex]; // mapping
     			}     			
     			// set the timer's reloaded-value
     			// MTx_TIMER_LOAD(chIndex, m_atMotorControl[chIndex].nTimeLoad);     
     			// counting
     			g_tMotorStatus[eMotor].nStepsDec    	-= 1;
     			g_tMotorStatus[eMotor].nSteps		  	-= 1;  //g_tMotorStatus[eMotor].nStepsTotal  -= 1;
				g_tMotorStatus[eMotor].nStepsExecuted  += 1;
     			// add 1
     			s_nTheSameStepsCount++;
     			
     			break;	 // break out for next pulse	
     		}
			else 
		    {	
			    g_tMotorStatus[eMotor].ePhase        = Motor_Phase_FIN;
			    s_nTheSameStepsCount          		  = 0;
				Motor_Set_Current(MOTOR_CURRENT_VALUE_START);
                // don't break out "switch" and continue
		    }
		}
		//--
		case Motor_Phase_FIN:
		{
             MTx_DriverEnable(eMotor, FALSE);  // stop immediately
			 g_tMotorStatus[eMotor].eFinish 		  = TRUE;
             g_tMotorStatus[eMotor].ePhase           = Motor_Phase_IDLE;
			 Motor_Set_Current(MOTOR_CURRENT_VALUE_START);
			 break;
		}
		//--
		default:
		{
             MTx_DriverEnable(eMotor, FALSE);  // stop immediately
			 g_tMotorStatus[eMotor].eFinish		  = TRUE;
             g_tMotorStatus[eMotor].ePhase           = Motor_Phase_IDLE;
			 Motor_Set_Current(MOTOR_CURRENT_VALUE_START);
			 break;
		}
	} // end of "switch"
	
	
	// 2) compute the absolute location
    if( Motor_Phase_IDLE != g_tMotorStatus[eMotor].ePhase)
    {
        //       --- 1 ---    
//		if(e_Dir_Neg == g_tMotorStatus[eMotor].eDir)
//		{
//			if(g_tMotorStatus[eMotor].nStepsCur > 0)
//			{
//				g_tMotorStatus[eMotor].nStepsCur -= 1;
//			} 
//		}
//		else
//		{
//			if(g_tMotorStatus[eMotor].nStepsCur < MTx_VALUE_DISTANCE_MAX(eMotor))
//			{ 
//				g_tMotorStatus[eMotor].nStepsCur += 1;
//			}
//		}
    } // end of if

    // 3) monitor the change of the special IO's level
#if 1
    MTx_IoMinitor(eMotor);
#endif

    // 4) ending current pulse, pulls down 
	Delay_US(5);
    Motor_PWM_Low(eMotor); //MTx_OUT_PULSE_LOW(eMotor); 

	//************************************************************
    //------------------------------------------------------------
	// 4. for debug, outputs the curve
#if 0//OPEN_DEBUG // MTx_WAVE_OUTPUT(chIndex)
    MTx_TIMER_COUNT_OFF(chIndex);     // disable counting of the timer
/*                              // real-time output the frequence of the motors
    printf("Phase:%0.2u - V:%0.6u, L:%0.8X ", 
                 (int)m_atMotorControl[chIndex].ePhase, 
                 (int)m_atMotorControl[chIndex].nCurFreq, 
                 (int)m_atMotorControl[chIndex].nTimeLoad ); 
*/    
    printf("Phase:%0.2u - V:%0.6u, L:%0.8X ", 
                 (int)m_atMotorControl[chIndex].ePhase, 
                 (int)m_atMotorControl[chIndex].nCurFreq, 
                 (int)m_atMotorControl[chIndex].nTimeLoad );
	if(Motor_Phase_IDLE != m_atMotorControl[chIndex].ePhase)
	{
        MTx_TIMER_COUNT_ON(chIndex);  // enable counting of the timer unless the movement has finished
	}
#endif
    

    //------------------------------------------------------------
	// 5. enable the timer
	MTx_TIMER_INTERRUPT_ON(eMotor);

    return;
}







/*
*   设置电极驱动电流，I = 0.766V，V = 1.3055I 
*/
void Motor_Set_Current(uint16_t usI)
{
    uint16_t usV = 0;
    extern DAC_HandleTypeDef hdac;
    
    //参数大小检测
    if(usI > MOTOR_I_MAX_VALUE) // 2000ma
    {
        usI = MOTOR_I_MAX_VALUE;
    }
    
    //设置DAC大小
    usV = 1.3055*usI;
    HAL_DAC_SetValue(&hdac, MOTOR_DAC_CHANNEL, DAC_ALIGN_12B_R, usV);
    HAL_DAC_Start(&hdac, MOTOR_DAC_CHANNEL);
}



/*
*   设置电机使能
*/
void Motor_Enable(Motor_e eMotor, Bool eBool)
{
    // 参数检查
    if(eMotor >= MOTOR_END)
    {
        LOG_Error("eMotor(%d)", eMotor);
    }
    
    //使能设置
    if(MOTOR_OUTIN == eMotor)
    {
         if(FALSE == eBool)
         {
            OUTIN_MOTOR_DISABLE;
         }else{
            OUTIN_MOTOR_ENABLE;
         }             
    }else if(MOTOR_CLAMP == eMotor){
         if(FALSE == eBool)
         {
            CLAMP_MOTOR_DISABLE;
         }else{
            CLAMP_MOTOR_ENABLE;
         } 
    }
}



/*
*   设置电机运行方向
*/
void Motor_Set_Dir(Motor_e eMotor, MotorDir_e eDir)
{
    // 参数检查
    if(eMotor >= MOTOR_END || eDir >= MOTOR_DIR_END)
    {
        LOG_Error("eMotor(%d) or eDir(%d) Error", eMotor, eDir);
    }
    
    //设置方向
    if(MOTOR_OUTIN == eMotor) 
    {
        if(MOTOR_DIR_OUT == eDir)
        {
            OUTIN_MOTOR_DIR_OUT;
        }else if(MOTOR_DIR_IN == eDir){
            OUTIN_MOTOR_DIR_IN;
        }
    }else if(MOTOR_CLAMP == eMotor){
        if(MOTOR_DIR_OUT == eDir)
        {
            CLAMP_MOTOR_DIR_IN;
        }else if(MOTOR_DIR_IN == eDir){
            CLAMP_MOTOR_DIR_OUT;
        }
    }
}



/*
* 获取电机光耦状体， eDir：那个方向的光耦
*/
uint8_t Motor_OC_Status(Motor_e eMotor, MotorDir_e eDir)
{
        // 参数检查
    if(eMotor >= MOTOR_END || eDir >= MOTOR_DIR_END)
    {
        LOG_Error("eMotor(%d) or eDir(%d) Error", eMotor, eDir);
    }
    
    //获取电机，对应光耦的状态
    if(MOTOR_OUTIN == eMotor) 
    {
        if(MOTOR_DIR_OUT == eDir)
        {
            OUTIN_OUT_OC_STATUS;
        }else if(MOTOR_DIR_IN == eDir){
            OUTIN_IN_OC_STATUS;
        }
    }else if(MOTOR_CLAMP == eMotor){
        if(MOTOR_DIR_OUT == eDir)
        {
            CLAMP_OUT_OC_STATUS;
        }else if(MOTOR_DIR_IN == eDir){
            CLAMP_IN_OC_STATUS;
        }
    }
    //
    return 0;

}



/*
* 电机PWM，高
*/
void Motor_PWM_High(Motor_e eMotor)
{
    if(eMotor >= MOTOR_END)
    {
        LOG_Error("eMotor(%d) Error", eMotor);
    }
    
    //设置PWM 高
    switch(eMotor)
    {
        case MOTOR_OUTIN:
        {
            OUTIN_MOTOR_PWM_HIGH;
        }
        break;
        case MOTOR_CLAMP:
        {
            CLAMP_MOTOR_PWM_HIGH;
        }
        break;
        default:
            break;
    }
}



/*
* 电机PWM，高
*/
void Motor_PWM_Low(Motor_e eMotor)
{
    if(eMotor >= MOTOR_END)
    {
        LOG_Error("eMotor(%d) Error", eMotor);
    }
    
    //设置PWM 高
    switch(eMotor)
    {
        case MOTOR_OUTIN:
        {
            OUTIN_MOTOR_PWM_LOW;
        }
        break;
        case MOTOR_CLAMP:
        {
            CLAMP_MOTOR_PWM_LOW;
        }
        break;
        default:
            break;
    }
}




/*
* 电机执行补偿步数
*/
FeedBack_e Motor_Run_AddStep(MotorMode_e eMode, Motor_e eMotor, MotorDir_e eDir, uint32_t ulAddStep)
{
    uint32_t ulExecStep = 0;
    FeedBack_e eFeedBack = FEED_BACK_SUCCESS;
    uint32_t ulStart = 0, ulEnd = 0;
    
    if(ulAddStep > 0)
    {
        MV_InitPara(eMotor, 1920, 10000, 100, 10);    // ZZC_0904   : MV_InitPara(EN_Motor1, 4000, 8000, 100, 10);
        MV_Move(eMotor, ulAddStep, eDir); // comes near the OC
        MTx_IoMinitor_Disnable(eMotor);

        ulStart = HAL_GetTick();
        ulEnd   = ulStart;
        while(ulEnd - ulStart <= MOTOR_MAX_TIMEOUT)
        {      
            ulExecStep = MV_GetStepsExecuted(eMotor);
            if(ulAddStep - ulExecStep <= 5)
            {
                MV_Stop(eMotor);
                break;
            }
            osDelay(2);
            ulEnd = HAL_GetTick();
        }
        MV_Stop(eMotor);
    }
    //超时检测
    if(ulEnd - ulStart > MOTOR_MAX_TIMEOUT)
    {
        eFeedBack = FEED_BACK_TIMEOUT;
        LOG_Info("AddStep Exec TimeOut");
    }
	
    return eFeedBack;
}



/*
* 进出仓电机,出仓  
*/
ErrorCode_e OutIn_Motor_Out(MotorMode_e eMode, uint32_t ulStep, uint32_t ulAddStep)
{
    extern MachInfo_s MachInfo;
    ErrorCode_e eStatus = ERROR_CODE_SUCCESS;
    uint32_t ulStart = 0, ulEnd = 0;

	//先判断下光耦是否都为挡住状态，是，则直接报异常即可
	if(OC_Status(OC_INDEX_OUTIN_IN) == SET && OC_Status(OC_INDEX_OUTIN_OUT) == SET){
		LOG_Info("OUTIN Motor Error");
		return ERROR_CODE_OUTIN_OUT;
	}
	
    if (SET != OC_Status(OC_INDEX_OUTIN_OUT)) //未触发
    {
        MV_InitPara(MOTOR_OUTIN, 3000, 10000, 100, 10);//MV_InitPara(MOTOR_OUTIN, 1920, 10000, 100, 10);    // ZZC_0904   : MV_InitPara(EN_Motor1, 4000, 8000, 100, 10);
        MV_Move(MOTOR_OUTIN, ulStep, MOTOR_DIR_OUT); // comes near the OC
        
        ulStart = HAL_GetTick();
        ulEnd   = ulStart;
        while(ulEnd - ulStart < MOTOR_MAX_TIMEOUT)
        {
            //步数执行完，但是还是没有触发光耦
            if (TRUE == MV_IsFinished(MOTOR_OUTIN))
            {
                MV_Stop(MOTOR_OUTIN);
                if(MV_GetStepsExecuted(MOTOR_OUTIN) >= ulStep)
                {
					LOG_Info("OUTIN Motor Out ERR");
                    eStatus = ERROR_CODE_OUTIN_OUT;
                }
                break;
            }
            
            //更新计时
            osDelay(2);// Motor_Delay(eMode, 2); //osDelay(2);
            ulEnd = HAL_GetTick();
        } 
        //停止
        MV_Stop(MOTOR_OUTIN);
        
        //超时检测
        if(ulEnd - ulStart > MOTOR_MAX_TIMEOUT)
        {
            eStatus = ERROR_CODE_OUTIN_OUT;
            LOG_Info("OUTIN Motor Timeout");
        }
       
        //补偿步数
        if(FEED_BACK_SUCCESS != Motor_Run_AddStep(eMode, MOTOR_OUTIN, MOTOR_DIR_OUT, ulAddStep))
        {
            eStatus = ERROR_CODE_OUTIN_OUT;
        }
    }

    //返回状态
    return eStatus;
}



/*
* 进出仓电机，进仓
*/
ErrorCode_e OutIn_Motor_In(MotorMode_e eMode, uint32_t ulStep, uint32_t ulAddStep)
{
   extern MachInfo_s MachInfo;
   ErrorCode_e eStatus = ERROR_CODE_SUCCESS;
   uint32_t ulStart = 0, ulEnd = 0;
    
	//先判断下光耦是否都为挡住状态，是，则直接报异常即可
	if(OC_Status(OC_INDEX_OUTIN_IN) == SET && OC_Status(OC_INDEX_OUTIN_OUT) == SET){
		LOG_Info("OUTIN Motor Error");
		return ERROR_CODE_OUTIN_IN;
	}
	
    if (SET != OC_Status(OC_INDEX_OUTIN_IN)) //未触发
    {
        MV_InitPara(MOTOR_OUTIN, 1920, 10000, 100, 10);    // ZZC_0904   : MV_InitPara(EN_Motor1, 4000, 8000, 100, 10);
        MV_Move(MOTOR_OUTIN, ulStep, MOTOR_DIR_IN); 
        
        ulStart = HAL_GetTick();
        ulEnd   = ulStart;
        while(ulEnd - ulStart < MOTOR_MAX_TIMEOUT)
        {
            //步数执行完，但是还是没有触发光耦
            if (TRUE == MV_IsFinished(MOTOR_OUTIN))
            {
                MV_Stop(MOTOR_OUTIN);
                if(MV_GetStepsExecuted(MOTOR_OUTIN) >= ulStep)
                {
					LOG_Info("OUTIN Motor In ERR");
                    eStatus = ERROR_CODE_OUTIN_IN;
                }
                break;
            }
            
            //更新计时
            osDelay(2);
            ulEnd = HAL_GetTick();
        } 
        //停止
        MV_Stop(MOTOR_OUTIN);
        
        //超时检测
        if(ulEnd - ulStart > MOTOR_MAX_TIMEOUT)
        {
            eStatus = ERROR_CODE_OUTIN_IN;
            LOG_Info("OUTIN Motor Timeout");
            return eStatus;
        }
     
        //补偿步数
        if(FEED_BACK_SUCCESS != Motor_Run_AddStep(eMode, MOTOR_OUTIN, MOTOR_DIR_IN, ulAddStep))
        {
            eStatus = ERROR_CODE_OUTIN_IN;
        }
    }
    //返回状态
    return eStatus;
}



/*
*	执行电机进仓或出仓
*/
ErrorCode_e OutIn_Motor_Out_Or_In(MotorMode_e eMode)
{
     extern MachInfo_s MachInfo;
     ErrorCode_e eStatus = ERROR_CODE_SUCCESS;
    
    //进仓光耦未触发
     if(OC_Status(OC_INDEX_OUTIN_IN) != SET)
     {
        eStatus = OutIn_Motor_In(eMode, MOTOR_CLAMP_MAX_STEP, MachInfo.paramSet.ulOutIn_In_AddStep);
     }else{
        eStatus = OutIn_Motor_Out(eMode, MOTOR_CLAMP_MAX_STEP, MachInfo.paramSet.ulOutIn_Out_AddStep);
     }
     
     //返回状态
    return eStatus;
}



/*
*	夹子电机, 往外走
*/
ErrorCode_e Clamp_Motor_Out(MotorMode_e eMode, uint32_t ulStep, uint32_t ulAddStep)
{
    extern MachInfo_s MachInfo;
    ErrorCode_e eStatus = ERROR_CODE_SUCCESS;
    uint32_t ulStart = 0, ulEnd = 0;
	
	//先判断下光耦是否都为挡住状态，是，则直接报异常即可
	if(OC_Status(OC_INDEX_CLAMP_OUT) == SET && OC_Status(OC_INDEX_CLAMP_IN) == SET){
		LOG_Info("Clamp Motor Error");
		return ERROR_CODE_CLAMP_OUT;
	}
    
    if (SET != OC_Status(OC_INDEX_CLAMP_OUT)) //未触发
    {
        MV_InitPara(MOTOR_CLAMP, 1920, 10000, 100, 10);    // ZZC_0904   : MV_InitPara(EN_Motor1, 4000, 8000, 100, 10);
        MV_Move(MOTOR_CLAMP, ulStep, MOTOR_DIR_OUT); // comes near the OC
        
        ulStart = HAL_GetTick();
        ulEnd   = ulStart;
        while(ulEnd - ulStart < MOTOR_MAX_TIMEOUT)
        {
            //步数执行完，但是还是没有触发光耦
            if (TRUE == MV_IsFinished(MOTOR_CLAMP))
            {
                MV_Stop(MOTOR_CLAMP);
                if(MV_GetStepsExecuted(MOTOR_CLAMP) >= ulStep)
                {
					LOG_Info("Clamp Motor Out ERR");
                    eStatus = ERROR_CODE_CLAMP_OUT;
                }
                break;
            }
            
            //更新计时
            osDelay(2);// Motor_Delay(eMode, 2); //osDelay(2);
            ulEnd = HAL_GetTick();
        } 
        //停止
        MV_Stop(MOTOR_CLAMP);
        
        //超时检测
        if(ulEnd - ulStart > MOTOR_MAX_TIMEOUT)
        {
            eStatus = ERROR_CODE_CLAMP_OUT;
            LOG_Info("Clamp Motor Timeout");
            return eStatus;
        }
        
        //补偿步数
        if(FEED_BACK_SUCCESS != Motor_Run_AddStep(eMode, MOTOR_CLAMP, MOTOR_DIR_OUT, ulAddStep))
        {
            eStatus = ERROR_CODE_CLAMP_OUT;
        }
    }
    //返回状态
    return eStatus;
}



/*
*	夹子电机，往里走
*/
ErrorCode_e Clamp_Motor_In(MotorMode_e eMode, uint32_t ulStep, uint32_t ulAddStep)
{
    extern MachInfo_s MachInfo;
    ErrorCode_e eStatus = ERROR_CODE_SUCCESS;
    uint32_t ulStart = 0, ulEnd = 0;
    
	//先判断下光耦是否都为挡住状态，是，则直接报异常即可
	if(OC_Status(OC_INDEX_CLAMP_OUT) == SET && OC_Status(OC_INDEX_CLAMP_IN) == SET){
		LOG_Info("Clamp Motor Error");
		return ERROR_CODE_CLAMP_IN;
	}
	
    if (SET != OC_Status(OC_INDEX_CLAMP_IN)) //未触发
    {
        MV_InitPara(MOTOR_CLAMP, 1920, 10000, 100, 10);    // ZZC_0904   : MV_InitPara(EN_Motor1, 4000, 8000, 100, 10);
        MV_Move(MOTOR_CLAMP, ulStep, MOTOR_DIR_IN); // comes near the OC
        
        ulStart = HAL_GetTick();
        ulEnd   = ulStart;
        while(ulEnd - ulStart < MOTOR_MAX_TIMEOUT)
        {
            //步数执行完，但是还是没有触发光耦
            if (TRUE == MV_IsFinished(MOTOR_CLAMP))
            {
                MV_Stop(MOTOR_CLAMP);
                if(MV_GetStepsExecuted(MOTOR_CLAMP) >= ulStep)
                {
					LOG_Info("Clamp Motor In ERR");
                    eStatus = ERROR_CODE_CLAMP_IN;
                }
                break;
            }
            
            //更新计时
            osDelay(2);
            ulEnd = HAL_GetTick();
        } 
    
        //停止
        MV_Stop(MOTOR_CLAMP);
        
        //超时检测
        if(ulEnd - ulStart > MOTOR_MAX_TIMEOUT)
        {
            eStatus = ERROR_CODE_CLAMP_IN;
            LOG_Info("Clamp Motor Timeout");
            return eStatus;
        }
        
        //补偿步数
        if(FEED_BACK_SUCCESS != Motor_Run_AddStep(eMode, MOTOR_CLAMP, MOTOR_DIR_IN, ulAddStep))
        {
            eStatus = ERROR_CODE_CLAMP_IN;
        }
    }
     
    //返回状态
    return eStatus;
}



/*
*	夹子电机
*/
ErrorCode_e Clamp_Motor_Out_Or_In(MotorMode_e eMode)
{
    extern MachInfo_s MachInfo;
    ErrorCode_e eStatus = ERROR_CODE_SUCCESS;

    //夹子往里走，检测光耦是否触发
     if(OC_Status(OC_INDEX_CLAMP_IN) != SET) //未触发
     {
        eStatus = Clamp_Motor_In(eMode, MOTOR_CLAMP_MAX_STEP, MachInfo.paramSet.ulClamp_In_AddStep);
     }else{
        eStatus = Clamp_Motor_Out(eMode, MOTOR_CLAMP_MAX_STEP, MachInfo.paramSet.ulClamp_Out_AddStep);
     }
     
    //返回状态
    return eStatus;
}



/*
*	夹子电机，气嘴重新对接（先松后紧）
*/
ErrorCode_e Clamp_Motor_Out_then_In(MotorMode_e eMode)
{
    extern MachInfo_s MachInfo;
    ErrorCode_e eStatus = ERROR_CODE_SUCCESS;

    if(OC_Status(OC_INDEX_CLAMP_IN) != SET) 
    {
        //如果已是松开状态，则跳过该步骤
        eStatus = Clamp_Motor_In(eMode, MOTOR_CLAMP_MAX_STEP, MachInfo.paramSet.ulClamp_In_AddStep);
    }
    eStatus = Clamp_Motor_Out(eMode, MOTOR_CLAMP_MAX_STEP, MachInfo.paramSet.ulClamp_Out_AddStep);

    
//    //夹子往里走，检测光耦是否触发
//     if(OC_Status(OC_INDEX_CLAMP_IN) != SET) //未触发
//     {
//        eStatus = Clamp_Motor_In(eMode, MOTOR_CLAMP_MAX_STEP, MachInfo.paramSet.ulClamp_In_AddStep);
//     }else{
//        eStatus = Clamp_Motor_Out(eMode, MOTOR_CLAMP_MAX_STEP, MachInfo.paramSet.ulClamp_Out_AddStep);
//     }
//     
    //返回状态
    return eStatus;
}




/*
*	进出仓模块，进(正常模式，包括两部分动作，1：夹子电机往外走，加紧计数池，2：进出仓电机往里走)
*
*   正常模式：探针电机会夹紧，计数模式：探针电机不加紧
*/
ErrorCode_e OutIn_Module_In(MotorMode_e eMode)
{
    extern MachInfo_s MachInfo;
    ErrorCode_e eOutInStatus = ERROR_CODE_SUCCESS, eClampStatus = ERROR_CODE_SUCCESS;
    
    //夹子电机往外走
	eClampStatus = Clamp_Motor_Out(eMode, MOTOR_CLAMP_MAX_STEP, MachInfo.paramSet.ulClamp_Out_AddStep);
	if(ERROR_CODE_SUCCESS != eClampStatus)
		return eClampStatus;

    //进出仓电机往里走
	eOutInStatus = OutIn_Motor_In(eMode, MOTOR_OUTIN_MAX_STEP, MachInfo.paramSet.ulOutIn_In_AddStep);
	if(ERROR_CODE_SUCCESS != eOutInStatus)
		return eOutInStatus;

    return ERROR_CODE_SUCCESS;
}





/*
*	进出仓模块，出(包括两部分动作，1：夹子电机往里走，松开计数池，2：进出仓电机往外走)
*/
ErrorCode_e OutIn_Module_Out(MotorMode_e eMode)
{
    extern MachInfo_s MachInfo;
    ErrorCode_e eOutInStatus = ERROR_CODE_SUCCESS, eClampStatus = ERROR_CODE_SUCCESS;
    
    //进仓电机，出仓光耦未触发， 进出仓电机往外走
	eOutInStatus = OutIn_Motor_Out(eMode, MOTOR_OUTIN_MAX_STEP, MachInfo.paramSet.ulOutIn_Out_AddStep);
	if(ERROR_CODE_SUCCESS != eOutInStatus)
		return eOutInStatus;
    
    //夹子电机，进仓光耦未触发，夹子电机往里走
	eClampStatus = Clamp_Motor_In(eMode, MOTOR_CLAMP_MAX_STEP, MachInfo.paramSet.ulClamp_In_AddStep);
	if(ERROR_CODE_SUCCESS != eClampStatus)
		return eClampStatus;
    
    return ERROR_CODE_SUCCESS;
}




/*
*	进出仓模块，出or进
*/
ErrorCode_e OutIn_Module_Out_Or_In(MotorMode_e eMode)
{
    extern __IO OutIn_Module_Position_e g_eOutIn_Key;
    ErrorCode_e eStatus = ERROR_CODE_SUCCESS;
   
    if(OUTIN_MODULE_POSITION_IN == g_eOutIn_Key) 
    {   
        eStatus = OutIn_Module_In(eMode);  //进出
    }else{
        eStatus = OutIn_Module_Out(eMode);  //出仓
    }
    return eStatus;
}    



/*
*   获取进仓模块，位置（出仓，进仓，未知）
*/
OutIn_Module_Position_e OutIn_Module_Positon(void)
{
    OutIn_Module_Position_e ePos = OUTIN_MODULE_POSITION_NUKNOWN;
        
    if(OC_Status(OC_INDEX_OUTIN_OUT) == SET && OC_Status(OC_INDEX_CLAMP_IN) == SET)
    {
        //出仓位置
        ePos = OUTIN_MODULE_POSITION_OUT;
    }else if(OC_Status(OC_INDEX_OUTIN_IN) == SET && OC_Status(OC_INDEX_CLAMP_OUT) == SET){
        
        //进仓位置
        ePos = OUTIN_MODULE_POSITION_IN;
    }else {
        
        //不确定位置
        ePos = OUTIN_MODULE_POSITION_NUKNOWN; //当不确定位置时，（当按进仓键时，会在在中断中会反转为0,出仓）
    }
    //
    return ePos;
}






#ifdef CX_DEBUG
//
#endif







